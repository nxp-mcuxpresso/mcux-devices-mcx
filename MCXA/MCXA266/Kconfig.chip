## MCXA/MCXA266/Kconfig.chip
```kconfig
# Copyright 2025 NXP
#
# SPDX-License-Identifier: BSD-3-Clause

# core related
config MCUX_HW_CORE
    string
    default "cm33"

config MCUX_HW_CORE_CM33
    bool
    default y

config MCUX_HW_CORE_ID
    string
    default "cm33_core0"

config MCUX_HW_CORE_ID_CM33_CORE0
    bool
    default y

config MCUX_HW_DEVICE_CORE
    string
    default "MCXA266"

config MCUX_HW_FPU
    string
    default "SP_FPU"

config MCUX_HW_FPU_TYPE
    string
    default "fpv5_sp"

config MCUX_HW_FPV5_SP
    bool
    default y

config MCUX_HW_INT_PRIO_BITS
    int
    default 3

config MCUX_HW_DSP
    bool
    default y

config MCUX_HW_SAU
    bool
    default n

config MCUX_HW_SOC_SERIES_MCX
    bool
    default y

config MCUX_HW_SOC_SINGLECORE_DEVICE
    bool
    default y

# device related

config MCUX_HW_DEVICE_ID_MCXA266
    bool

choice MCUX_HW_DEVICE_PART_MCXA266
    prompt "Device MCXA266 Part"
    config MCUX_HW_DEVICE_PART_MCXA266VLQ
    bool "MCXA266VLQ"
    select MCUX_HW_DEVICE_ID_MCXA266
    config MCUX_HW_DEVICE_PART_MCXA266VLL
    bool "MCXA266VLL"
    select MCUX_HW_DEVICE_ID_MCXA266
    config MCUX_HW_DEVICE_PART_MCXA266VLH
    bool "MCXA266VLH"
    select MCUX_HW_DEVICE_ID_MCXA266
    config MCUX_HW_DEVICE_PART_MCXA266VPN
    bool "MCXA266VPN"
    select MCUX_HW_DEVICE_ID_MCXA266
endchoice

config MCUX_HW_DEVICE_ID
    string
    default "MCXA266" if MCUX_HW_DEVICE_ID_MCXA266

config MCUX_HW_DEVICE_PART
    string
    default "MCXA266VLQ" if MCUX_HW_DEVICE_PART_MCXA266VLQ
    default "MCXA266VLL" if MCUX_HW_DEVICE_PART_MCXA266VLL
    default "MCXA266VLH" if MCUX_HW_DEVICE_PART_MCXA266VLH
    default "MCXA266VPN" if MCUX_HW_DEVICE_PART_MCXA266VPN

# For chipmodel generated files
config MCUX_TOOLCHAIN_LINKER_DEVICE_PREFIX
    string
    default "MCXA266" if MCUX_HW_DEVICE_ID_MCXA266

config MCUX_TOOLCHAIN_MCUX_STARTUP
    string
    default "mcxa266"

# Toolchain related

config MCUX_TOOLCHAIN_IAR_CPU_IDENTIFIER
    string
    default "MCXA266" if MCUX_HW_DEVICE_ID_MCXA266

config MCUX_TOOLCHAIN_MDK_CPU_IDENTIFIER
    string
    default "MCXA266VLQ" if MCUX_HW_DEVICE_PART_MCXA266VLQ
    default "MCXA266VLL" if MCUX_HW_DEVICE_PART_MCXA266VLL
    default "MCXA266VLH" if MCUX_HW_DEVICE_PART_MCXA266VLH
    default "MCXA266VPN" if MCUX_HW_DEVICE_PART_MCXA266VPN

config MCUX_TOOLCHAIN_JLINK_CPU_IDENTIFIER
    string
    default "MCXA266" if MCUX_HW_DEVICE_ID_MCXA266

config MCUX_HW_IP_DriverType_FLEXIO_MCULCD
    bool
    default y
    depends on MCUX_HW_DEVICE_ID_MCXA266

# ip information
config MCUX_HW_IP_DriverType_AOI
    bool
    default y
    depends on MCUX_HW_DEVICE_ID_MCXA266

config MCUX_HW_IP_DriverType_CDOG
    bool
    default y
    depends on MCUX_HW_DEVICE_ID_MCXA266

config MCUX_HW_IP_DriverType_CRC
    bool
    default y
    depends on MCUX_HW_DEVICE_ID_MCXA266

config MCUX_HW_IP_DriverType_CTIMER
    bool
    default y
    depends on MCUX_HW_DEVICE_ID_MCXA266

config MCUX_HW_IP_DriverType_DBGMB
    bool
    default y
    depends on MCUX_HW_DEVICE_ID_MCXA266

config MCUX_HW_IP_DriverType_DIGTMP
    bool
    default y
    depends on MCUX_HW_DEVICE_ID_MCXA266

config MCUX_HW_IP_DriverType_EDMA3
    bool
    default y
    depends on MCUX_HW_DEVICE_ID_MCXA266

config MCUX_HW_IP_DriverType_EIM
    bool
    default y
    depends on MCUX_HW_DEVICE_ID_MCXA266

config MCUX_HW_IP_DriverType_EQDC
    bool
    default y
    depends on MCUX_HW_DEVICE_ID_MCXA266

config MCUX_HW_IP_DriverType_ERM
    bool
    default y
    depends on MCUX_HW_DEVICE_ID_MCXA266

config MCUX_HW_IP_DriverType_FLEXCAN
    bool
    default y
    depends on MCUX_HW_DEVICE_ID_MCXA266

config MCUX_HW_IP_DriverType_FLEXIO
    bool
    default y
    depends on MCUX_HW_DEVICE_ID_MCXA266

config MCUX_HW_IP_DriverType_FMC
    bool
    default y
    depends on MCUX_HW_DEVICE_ID_MCXA266

config MCUX_HW_IP_DriverType_FMU
    bool
    default y
    depends on MCUX_HW_DEVICE_ID_MCXA266

config MCUX_HW_IP_DriverType_FREQME
    bool
    default y
    depends on MCUX_HW_DEVICE_ID_MCXA266

config MCUX_HW_IP_DriverType_GLIKEY
    bool
    default y
    depends on MCUX_HW_DEVICE_ID_MCXA266

config MCUX_HW_IP_DriverType_GPIO
    bool
    default y
    depends on MCUX_HW_DEVICE_ID_MCXA266

config MCUX_HW_IP_DriverType_I3C
    bool
    default y
    depends on MCUX_HW_DEVICE_ID_MCXA266

config MCUX_HW_IP_DriverType_INPUTMUX
    bool
    default y
    depends on MCUX_HW_DEVICE_ID_MCXA266

config MCUX_HW_IP_DriverType_LPADC
    bool
    default y
    depends on MCUX_HW_DEVICE_ID_MCXA266

config MCUX_HW_IP_DriverType_LPCMP
    bool
    default y
    depends on MCUX_HW_DEVICE_ID_MCXA266

config MCUX_HW_IP_DriverType_LPC_SYSCON
    bool
    default y
    depends on MCUX_HW_DEVICE_ID_MCXA266

config MCUX_HW_IP_DriverType_LPDAC
    bool
    default y
    depends on MCUX_HW_DEVICE_ID_MCXA266

config MCUX_HW_IP_DriverType_LPI2C
    bool
    default y
    depends on MCUX_HW_DEVICE_ID_MCXA266

config MCUX_HW_IP_DriverType_LPSPI
    bool
    default y
    depends on MCUX_HW_DEVICE_ID_MCXA266

config MCUX_HW_IP_DriverType_LPTMR
    bool
    default y
    depends on MCUX_HW_DEVICE_ID_MCXA266

config MCUX_HW_IP_DriverType_LPUART
    bool
    default y
    depends on MCUX_HW_DEVICE_ID_MCXA266

config MCUX_HW_IP_DriverType_MAU
    bool
    default y
    depends on MCUX_HW_DEVICE_ID_MCXA266

config MCUX_HW_IP_DriverType_MCX_CMC
    bool
    default y
    depends on MCUX_HW_DEVICE_ID_MCXA266

config MCUX_HW_IP_DriverType_MCX_SPC
    bool
    default y
    depends on MCUX_HW_DEVICE_ID_MCXA266

config MCUX_HW_IP_DriverType_MCX_VBAT
    bool
    default y
    depends on MCUX_HW_DEVICE_ID_MCXA266

config MCUX_HW_IP_DriverType_MRCC
    bool
    default y
    depends on MCUX_HW_DEVICE_ID_MCXA266

config MCUX_HW_IP_DriverType_OPAMP_FAST
    bool
    default y
    depends on MCUX_HW_DEVICE_ID_MCXA266

config MCUX_HW_IP_DriverType_OSTIMER
    bool
    default y
    depends on MCUX_HW_DEVICE_ID_MCXA266

config MCUX_HW_IP_DriverType_PORT
    bool
    default y
    depends on MCUX_HW_DEVICE_ID_MCXA266

config MCUX_HW_IP_DriverType_PKC
    bool
    default y
    depends on MCUX_HW_DEVICE_ID_MCXA266

config MCUX_HW_IP_DriverType_PWM
    bool
    default y
    depends on MCUX_HW_DEVICE_ID_MCXA266

config MCUX_HW_IP_DriverType_SRTC
    bool
    default y
    depends on MCUX_HW_DEVICE_ID_MCXA266

config MCUX_HW_IP_DriverType_SCG
    bool
    default y
    depends on MCUX_HW_DEVICE_ID_MCXA266

config MCUX_HW_IP_DriverType_SGI
    bool
    default y
    depends on MCUX_HW_DEVICE_ID_MCXA266

config MCUX_HW_IP_DriverType_SLCD40
    bool
    default y
    depends on MCUX_HW_DEVICE_ID_MCXA266

config MCUX_HW_IP_DriverType_SMARTDMA
    bool
    default y
    depends on MCUX_HW_DEVICE_ID_MCXA266

config MCUX_HW_IP_DriverType_SYSCON_LPCAC
    bool
    default y
    depends on MCUX_HW_DEVICE_ID_MCXA266

config MCUX_HW_IP_DriverType_TRDC_1
    bool
    default y
    depends on MCUX_HW_DEVICE_ID_MCXA266

config MCUX_HW_IP_DriverType_USB_HOST_DEVICE_KHCI
    bool
    default y
    depends on MCUX_HW_DEVICE_ID_MCXA266

config MCUX_HW_IP_DriverType_UTICK
    bool
    default y
    depends on MCUX_HW_DEVICE_ID_MCXA266

config MCUX_HW_IP_DriverType_WAKETIMER
    bool
    default y
    depends on MCUX_HW_DEVICE_ID_MCXA266

config MCUX_HW_IP_DriverType_WUU
    bool
    default y
    depends on MCUX_HW_DEVICE_ID_MCXA266

config MCUX_HW_IP_DriverType_WWDT
    bool
    default y
    depends on MCUX_HW_DEVICE_ID_MCXA266

config MCUX_HW_IP_DriverType_TRNG
    bool
    default y
    depends on MCUX_HW_DEVICE_ID_MCXA266
```

## MCXA/MCXA346/drivers/Kconfig
```kconfig
# Copyright 2025-2026 NXP
# All rights reserved.
#
# SPDX-License-Identifier: BSD-3-Clause

menu "Device specific drivers configuration"

    rsource "../../MCXA153/drivers/romapi/Kconfig"

    config MCUX_COMPONENT_driver.clock
         bool "clock"
         default y

    config MCUX_COMPONENT_driver.edma_soc
         bool "edma_soc"
         default n

    config MCUX_COMPONENT_driver.inputmux_connections
         bool "inputmux_connections"
         default y

    config MCUX_COMPONENT_driver.reset
         bool "reset"
         default y

    config MCUX_COMPONENT_driver.trdc_soc
         bool "trdc_soc"
         default n

if MCUX_COMPONENT_driver.clock || MCUX_COMPONENT_driver.reset
    config SOC_DRIVER_RETRY_TIMES
        int "Max loops to wait for operation complete (0 means wait forever)"
        default 0
        help
          This parameter defines how many loops to check completion before return timeout.
          If defined as 0, driver will wait forever until completion.
endif

endmenu
```
