## MCXW/MCXW235/Kconfig.chip
```kconfig
# core related
config MCUX_HW_CORE
    string
    default "cm33"

config MCUX_HW_CORE_CM33
    bool
    default y

config MCUX_HW_CORE_ID
    string
    default "cm33"

config MCUX_HW_CORE_ID_CM33
    bool
    default y

config MCUX_HW_DEVICE_CORE
    string
    default "MCXW235"

config MCUX_HW_FPU
    string
    default "SP_FPU"

config MCUX_HW_FPU_TYPE
    string
    default "fpv5_sp"

config MCUX_HW_FPV5_SP
    bool
    default y

config MCUX_HW_INT_PRIO_BITS
    int
    default 3

config MCUX_HW_DSP
    bool
    default y

config MCUX_HW_SAU
    bool
    default y

config MCUX_HW_SOC_SERIES_MCX
    bool
    default y

# device related

config MCUX_HW_DEVICE_ID_MCXW235
    bool

choice
    prompt "Device MCXW235 Part"
    config MCUX_HW_DEVICE_PART_MCXW235BIHNAR
    bool "MCXW235BIHNAR"
    select MCUX_HW_DEVICE_ID_MCXW235
    config MCUX_HW_DEVICE_PART_MCXW235BIUKAR
    bool "MCXW235BIUKAR"
    select MCUX_HW_DEVICE_ID_MCXW235
endchoice

config MCUX_HW_DEVICE_ID
    string
    default "MCXW235" if MCUX_HW_DEVICE_ID_MCXW235

config MCUX_HW_DEVICE_PART
    string
    default "MCXW235BIHNAR" if MCUX_HW_DEVICE_PART_MCXW235BIHNAR
    default "MCXW235BIUKAR" if MCUX_HW_DEVICE_PART_MCXW235BIUKAR

# For chipmodel generated files
config MCUX_TOOLCHAIN_LINKER_DEVICE_PREFIX
    string
    default "MCXW235" if MCUX_HW_DEVICE_ID_MCXW235

config MCUX_TOOLCHAIN_MCUX_STARTUP
    string
    default "mcxw235"

# Toolchain related

config MCUX_TOOLCHAIN_IAR_CPU_IDENTIFIER
    string
    default "MCXW235" if MCUX_HW_DEVICE_ID_MCXW235

config MCUX_TOOLCHAIN_MDK_CPU_IDENTIFIER
    string
    default "MCXW235BIHNAR" if MCUX_HW_DEVICE_PART_MCXW235BIHNAR
    default "MCXW235BIUKAR" if MCUX_HW_DEVICE_PART_MCXW235BIUKAR

config MCUX_TOOLCHAIN_JLINK_CPU_IDENTIFIER
    string
    default "MCXW235" if MCUX_HW_DEVICE_ID_MCXW235

# ip information
config MCUX_HW_IP_DriverType_ANALOGCTRL
    bool
    default y
    depends on MCUX_HW_DEVICE_ID_MCXW235

config MCUX_HW_IP_DriverType_CASPER
    bool
    default y
    depends on MCUX_HW_DEVICE_ID_MCXW235

config MCUX_HW_IP_DriverType_CDOG
    bool
    default y
    depends on MCUX_HW_DEVICE_ID_MCXW235

config MCUX_HW_IP_DriverType_CTIMER
    bool
    default y
    depends on MCUX_HW_DEVICE_ID_MCXW235

config MCUX_HW_IP_DriverType_FLEXCOMM
    bool
    default y
    depends on MCUX_HW_DEVICE_ID_MCXW235

config MCUX_HW_IP_DriverType_FLEXCOMM_I2C
    bool
    default y
    depends on MCUX_HW_DEVICE_ID_MCXW235

config MCUX_HW_IP_DriverType_FLEXCOMM_SPI
    bool
    default y
    depends on MCUX_HW_DEVICE_ID_MCXW235

config MCUX_HW_IP_DriverType_SPIFI
    bool
    default y
    depends on MCUX_HW_DEVICE_ID_MCXW235

config MCUX_HW_IP_DriverType_FLEXCOMM_USART
    bool
    default y
    depends on MCUX_HW_DEVICE_ID_MCXW235

config MCUX_HW_IP_DriverType_GINT
    bool
    default y
    depends on MCUX_HW_DEVICE_ID_MCXW235

config MCUX_HW_IP_DriverType_GPIO_PORT
    bool
    default y
    depends on MCUX_HW_DEVICE_ID_MCXW235

config MCUX_HW_IP_DriverType_HASHCRYPT
    bool
    default y
    depends on MCUX_HW_DEVICE_ID_MCXW235

config MCUX_HW_IP_DriverType_INPUTMUX
    bool
    default y
    depends on MCUX_HW_DEVICE_ID_MCXW235

config MCUX_HW_IP_DriverType_IOCON
    bool
    default y
    depends on MCUX_HW_DEVICE_ID_MCXW235

config MCUX_HW_IP_DriverType_LPC_AHB_SECURE_CTRL
    bool
    default y
    depends on MCUX_HW_DEVICE_ID_MCXW235

config MCUX_HW_IP_DriverType_LPC_DBGMAILBOX
    bool
    default y
    depends on MCUX_HW_DEVICE_ID_MCXW235

config MCUX_HW_IP_DriverType_LPC_FLASH
    bool
    default y
    depends on MCUX_HW_DEVICE_ID_MCXW235

config MCUX_HW_IP_DriverType_LPC_FLASH_CFPA
    bool
    default y
    depends on MCUX_HW_DEVICE_ID_MCXW235

config MCUX_HW_IP_DriverType_LPC_FLASH_CMPA
    bool
    default y
    depends on MCUX_HW_DEVICE_ID_MCXW235

config MCUX_HW_IP_DriverType_LPC_FLASH_KEY_STORE
    bool
    default y
    depends on MCUX_HW_DEVICE_ID_MCXW235

config MCUX_HW_IP_DriverType_LPC_PMC
    bool
    default y
    depends on MCUX_HW_DEVICE_ID_MCXW235

config MCUX_HW_IP_DriverType_LPC_POWERLIB
    bool
    default y
    depends on MCUX_HW_DEVICE_ID_MCXW235

config MCUX_HW_IP_DriverType_LPC_PUF
    bool
    default y
    depends on MCUX_HW_DEVICE_ID_MCXW235

config MCUX_HW_IP_DriverType_LPC_PUF_SRAM_CTRL
    bool
    default y
    depends on MCUX_HW_DEVICE_ID_MCXW235

config MCUX_HW_IP_DriverType_RADIO
    bool
    default y
    depends on MCUX_HW_DEVICE_ID_MCXW235

config MCUX_HW_IP_DriverType_LPC_SECGPIO
    bool
    default y
    depends on MCUX_HW_DEVICE_ID_MCXW235

config MCUX_HW_IP_DriverType_LPC_SWD
    bool
    default y
    depends on MCUX_HW_DEVICE_ID_MCXW235

config MCUX_HW_IP_DriverType_MAILBOX
    bool
    default y
    depends on MCUX_HW_DEVICE_ID_MCXW235

config MCUX_HW_IP_DriverType_MCO_CRC
    bool
    default y
    depends on MCUX_HW_DEVICE_ID_MCXW235

config MCUX_HW_IP_DriverType_MRT
    bool
    default y
    depends on MCUX_HW_DEVICE_ID_MCXW235

config MCUX_HW_IP_DriverType_OSTIMER
    bool
    default y
    depends on MCUX_HW_DEVICE_ID_MCXW235

config MCUX_HW_IP_DriverType_PINT
    bool
    default y
    depends on MCUX_HW_DEVICE_ID_MCXW235

config MCUX_HW_IP_DriverType_PLU
    bool
    default y
    depends on MCUX_HW_DEVICE_ID_MCXW235

config MCUX_HW_IP_DriverType_PUF
    bool
    default y
    depends on MCUX_HW_DEVICE_ID_MCXW235

config MCUX_HW_IP_DriverType_RTC_LITE
    bool
    default y
    depends on MCUX_HW_DEVICE_ID_MCXW235

config MCUX_HW_IP_DriverType_SCTIMER
    bool
    default y
    depends on MCUX_HW_DEVICE_ID_MCXW235

config MCUX_HW_IP_DriverType_SDMA
    bool
    default y
    depends on MCUX_HW_DEVICE_ID_MCXW235

config MCUX_HW_IP_DriverType_UTICK
    bool
    default y
    depends on MCUX_HW_DEVICE_ID_MCXW235

config MCUX_HW_IP_DriverType_WWDT
    bool
    default y
    depends on MCUX_HW_DEVICE_ID_MCXW235

config MCUX_HW_IP_DriverType_ROMC
    bool
    default y
    depends on MCUX_HW_DEVICE_ID_MCXW235

config MCUX_HW_IP_DriverType_TRNG
    bool
    default y
    depends on MCUX_HW_DEVICE_ID_MCXW235
```

## MCXW/MCXW235/drivers/Kconfig
```kconfig
# Copyright 2024 NXP
#
# SPDX-License-Identifier: BSD-3-Clause

config MCUX_HAS_COMPONENT_driver.romapi
    bool
    default y

menu "Device specific drivers configuration"

    rsource "../../MCXW236/drivers/Kconfig_clock"
    rsource "../../MCXW236/drivers/Kconfig_inputmux_connections"
    rsource "../../MCXW236/drivers/Kconfig_power"
    rsource "../../MCXW236/drivers/Kconfig_reset"
    rsource "../../MCXW236/drivers/Kconfig_romapi"

endmenu
```

## MCXW/MCXW236B/Kconfig.defconfig
```kconfig
# Copyright 2024,2025 NXP
#
# SPDX-License-Identifier: BSD-3-Clause

config MCUX_PRJSEG_module.wireless.health_care_iot_common
    bool "Health Care IoT common layer"
    select MCUX_COMPONENT_component.osa
    select MCUX_COMPONENT_component.panic
    select MCUX_COMPONENT_middleware.wireless.framework
    select MCUX_COMPONENT_middleware.wireless.framework.platform
    select MCUX_COMPONENT_middleware.wireless.framework.nvm
    select MCUX_COMPONENT_middleware.wireless.framework.seclib_rng
    select MCUX_COMPONENT_middleware.wireless.framework.module_info
    select MCUX_COMPONENT_middleware.wireless.ble_host
    select MCUX_COMPONENT_middleware.wireless.ble_host_interface
    select MCUX_COMPONENT_middleware.wireless.ble_gatt_db
    select MCUX_COMPONENT_middleware.wireless.ble_host_common
    select MCUX_COMPONENT_middleware.wireless.ble_host_component_lib
```

## MCXW/MCXW236B/drivers/Kconfig
```kconfig
# Copyright 2024 NXP
#
# SPDX-License-Identifier: BSD-3-Clause

config MCUX_HAS_COMPONENT_driver.romapi
    bool
    default y

menu "Device specific drivers configuration"

    rsource "./Kconfig_clock"
    rsource "./Kconfig_inputmux_connections"
    rsource "./Kconfig_power"
    rsource "./Kconfig_reset"
    rsource "./Kconfig_romapi"

endmenu
```

## MCXW/MCXW70AA/drivers/Kconfig
```kconfig
# Copyright 2026 NXP
#
# SPDX-License-Identifier: BSD-3-Clause

menu "Device specific drivers configuration"
     rsource "../../MCXW70AC/drivers/Kconfig_clock"
     rsource "../../MCXW70AC/drivers/Kconfig_romapi"
     rsource "../../MCXW70AC/drivers/Kconfig_memory"
     rsource "../../MCXW70AC/drivers/Kconfig_trdc_soc"
endmenu
```

## MCXW/MCXW70AC/drivers/Kconfig
```kconfig
# Copyright 2025 NXP
#
# SPDX-License-Identifier: BSD-3-Clause

menu "Device specific drivers configuration"
     rsource "./Kconfig_clock"
     rsource "./Kconfig_romapi"
     rsource "./Kconfig_memory"
endmenu
```
