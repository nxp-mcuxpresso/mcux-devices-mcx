## MCXE/MCXE32B/Kconfig.chip
```kconfig
# Copyright 2024-2026 NXP
#
# SPDX-License-Identifier: BSD-3-Clause

# product related

config MCUX_HW_SOC_SERIES_MCX
    bool
    default y

config MCUX_HW_SOC_MULTICORE_DEVICE
    bool
    default y

# device related

config MCUX_HW_DEVICE_ID_MCXE32B
    bool

choice MCUX_HW_DEVICE_PART_MCXE32B
    prompt "Device MCXE32B Part"
    config MCUX_HW_DEVICE_PART_MCXE32BMPB
    bool "MCXE32BMPB"
    select MCUX_HW_DEVICE_ID_MCXE32B
endchoice

config MCUX_HW_DEVICE_ID
    string
    default "MCXE32B" if MCUX_HW_DEVICE_ID_MCXE32B

config MCUX_HW_DEVICE_PART
    string
    default "MCXE32BMPB" if MCUX_HW_DEVICE_PART_MCXE32BMPB

# ip information

config MCUX_HW_IP_DriverType_AIPS
    bool
    default y
    depends on MCUX_HW_DEVICE_ID_MCXE32B

config MCUX_HW_IP_DriverType_AXBS
    bool
    default y
    depends on MCUX_HW_DEVICE_ID_MCXE32B

config MCUX_HW_IP_DriverType_BCTU
    bool
    default y
    depends on MCUX_HW_DEVICE_ID_MCXE32B

config MCUX_HW_IP_DriverType_CMU_FC
    bool
    default y
    depends on MCUX_HW_DEVICE_ID_MCXE32B

config MCUX_HW_IP_DriverType_CMU_FM
    bool
    default y
    depends on MCUX_HW_DEVICE_ID_MCXE32B

config MCUX_HW_IP_DriverType_CORE
    bool
    default y
    depends on MCUX_HW_DEVICE_ID_MCXE32B

config MCUX_HW_IP_DriverType_CRC
    bool
    default y
    depends on MCUX_HW_DEVICE_ID_MCXE32B

config MCUX_HW_IP_DriverType_DMAMUX
    bool
    default y
    depends on MCUX_HW_DEVICE_ID_MCXE32B

config MCUX_HW_IP_DriverType_EDMA4
    bool
    default y
    depends on MCUX_HW_DEVICE_ID_MCXE32B

config MCUX_HW_IP_DriverType_EIM
    bool
    default y
    depends on MCUX_HW_DEVICE_ID_MCXE32B

config MCUX_HW_IP_DriverType_EMAC
    bool
    default y
    depends on MCUX_HW_DEVICE_ID_MCXE32B

config MCUX_HW_IP_DriverType_EMIOS
    bool
    default y
    depends on MCUX_HW_DEVICE_ID_MCXE32B

config MCUX_HW_IP_DriverType_ERM
    bool
    default y
    depends on MCUX_HW_DEVICE_ID_MCXE32B

config MCUX_HW_IP_DriverType_FLASH_C40
    bool
    default y
    depends on MCUX_HW_DEVICE_ID_MCXE32B

config MCUX_HW_IP_DriverType_FLEXCAN
    bool
    default y
    depends on MCUX_HW_DEVICE_ID_MCXE32B

config MCUX_HW_IP_DriverType_FLEXIO
    bool
    default y
    depends on MCUX_HW_DEVICE_ID_MCXE32B

config MCUX_HW_IP_DriverType_INTM
    bool
    default y
    depends on MCUX_HW_DEVICE_ID_MCXE32B

config MCUX_HW_IP_DriverType_JDC
    bool
    default y
    depends on MCUX_HW_DEVICE_ID_MCXE32B

config MCUX_HW_IP_DriverType_JTAGC
    bool
    default y
    depends on MCUX_HW_DEVICE_ID_MCXE32B

config MCUX_HW_IP_DriverType_LCU
    bool
    default y
    depends on MCUX_HW_DEVICE_ID_MCXE32B

config MCUX_HW_IP_DriverType_LPCMP
    bool
    default y
    depends on MCUX_HW_DEVICE_ID_MCXE32B

config MCUX_HW_IP_DriverType_LPI2C
    bool
    default y
    depends on MCUX_HW_DEVICE_ID_MCXE32B

config MCUX_HW_IP_DriverType_LPSPI
    bool
    default y
    depends on MCUX_HW_DEVICE_ID_MCXE32B

config MCUX_HW_IP_DriverType_LPUART
    bool
    default y
    depends on MCUX_HW_DEVICE_ID_MCXE32B

config MCUX_HW_IP_DriverType_MCM
    bool
    default y
    depends on MCUX_HW_DEVICE_ID_MCXE32B

config MCUX_HW_IP_DriverType_MC_RGM
    bool
    default y
    depends on MCUX_HW_DEVICE_ID_MCXE32B

config MCUX_HW_IP_DriverType_MDM_AP
    bool
    default y
    depends on MCUX_HW_DEVICE_ID_MCXE32B

#config MCUX_HW_IP_DriverType_MEMORY
#    bool
#    default y
#    depends on MCUX_HW_DEVICE_ID_MCXE32B

config MCUX_HW_IP_DriverType_MSCM
    bool
    default y
    depends on MCUX_HW_DEVICE_ID_MCXE32B

config MCUX_HW_IP_DriverType_MU_1
    bool
    default y
    depends on MCUX_HW_DEVICE_ID_MCXE32B

config MCUX_HW_IP_DriverType_PFLASH
    bool
    default y
    depends on MCUX_HW_DEVICE_ID_MCXE32B

config MCUX_HW_IP_DriverType_PIT
    bool
    default y
    depends on MCUX_HW_DEVICE_ID_MCXE32B

config MCUX_HW_IP_DriverType_PLLDIG
    bool
    default y
    depends on MCUX_HW_DEVICE_ID_MCXE32B

config MCUX_HW_IP_DriverType_PMC2
    bool
    default y
    depends on MCUX_HW_DEVICE_ID_MCXE32B

config MCUX_HW_IP_DriverType_QUADSPI
    bool
    default y
    depends on MCUX_HW_DEVICE_ID_MCXE32B

#config MCUX_HW_IP_DriverType_QuadSPI_ARDB
#    bool
#    default y
#    depends on MCUX_HW_DEVICE_ID_MCXE32B

config MCUX_HW_IP_DriverType_RTC_JDP
    bool
    default y
    depends on MCUX_HW_DEVICE_ID_MCXE32B

config MCUX_HW_IP_DriverType_SAI
    bool
    default y
    depends on MCUX_HW_DEVICE_ID_MCXE32B

config MCUX_HW_IP_DriverType_SAR_ADC
    bool
    default y
    depends on MCUX_HW_DEVICE_ID_MCXE32B

#config MCUX_HW_IP_DriverType_SDA_AP
#    bool
#    default y
#    depends on MCUX_HW_DEVICE_ID_MCXE32B

config MCUX_HW_IP_DriverType_SELFTEST
    bool
    default y
    depends on MCUX_HW_DEVICE_ID_MCXE32B

config MCUX_HW_IP_DriverType_SEMA42
    bool
    default y
    depends on MCUX_HW_DEVICE_ID_MCXE32B

config MCUX_HW_IP_DriverType_SIUL2
    bool
    default y
    depends on MCUX_HW_DEVICE_ID_MCXE32B

config MCUX_HW_IP_DriverType_STM
    bool
    default y
    depends on MCUX_HW_DEVICE_ID_MCXE32B

config MCUX_HW_IP_DriverType_SWT
    bool
    default y
    depends on MCUX_HW_DEVICE_ID_MCXE32B

config MCUX_HW_IP_DriverType_TEMPSENSE
    bool
    default y
    depends on MCUX_HW_DEVICE_ID_MCXE32B

config MCUX_HW_IP_DriverType_TRGMUX
    bool
    default y
    depends on MCUX_HW_DEVICE_ID_MCXE32B

config MCUX_HW_IP_DriverType_TSPC
    bool
    default y
    depends on MCUX_HW_DEVICE_ID_MCXE32B

config MCUX_HW_IP_DriverType_VIRT_WRAPPER
    bool
    default y
    depends on MCUX_HW_DEVICE_ID_MCXE32B

config MCUX_HW_IP_DriverType_WKPU
    bool
    default y
    depends on MCUX_HW_DEVICE_ID_MCXE32B

config MCUX_HW_IP_DriverType_XBIC
    bool
    default y
    depends on MCUX_HW_DEVICE_ID_MCXE32B

config MCUX_HW_IP_DriverType_XRDC
    bool
    default y
    depends on MCUX_HW_DEVICE_ID_MCXE32B

# Added
config MCUX_HW_IP_DriverType_FLEXIO_MCULCD
    bool
    default y
    depends on MCUX_HW_DEVICE_ID_MCXE32B

config MCUX_HW_IP_DriverType_DCM_GPR
    bool
    default y
    depends on MCUX_HW_DEVICE_ID_MCXE32B
```

## MCXE/MCXE32B/core0/Kconfig.chip
```kconfig
# Copyright 2024-2026 NXP
#
# SPDX-License-Identifier: BSD-3-Clause

# core related

config MCUX_HW_CORE
    string
    default "cm7f"

config MCUX_HW_CORE_CM7F
    bool
    default y

config MCUX_HW_CORE_ID
    string
    default "core0"

config MCUX_HW_CORE_ID_CORE0
    bool
    default y

config MCUX_HW_DSP
    bool
    default n

config MCUX_HW_MPU
    bool
    default y

config MCUX_HW_FPU
    string
    default "SP_FPU"

config MCUX_HW_FPU_TYPE
    string
    default "fpv5_sp"

config MCUX_HW_FPV5_SP
    bool
    default y

config MCUX_HW_SAU
    bool
    default n

config MCUX_HW_INT_PRIO_BITS
    int
    default 4

# device related

config MCUX_HW_DEVICE_CORE
    string
    default "MCXE32B_cm7_core0"

# For chipmodel generated files

config MCUX_TOOLCHAIN_LINKER_DEVICE_PREFIX
    string
    default "MCXE32B_cm7_core0" if MCUX_HW_DEVICE_ID_MCXE32B

config MCUX_TOOLCHAIN_MCUX_STARTUP
    string
    default "mcxe32b_cm7_core0"

# Toolchain related

config MCUX_TOOLCHAIN_IAR_CPU_IDENTIFIER
    string
    default "MCXE32B_core0" if MCUX_HW_DEVICE_ID_MCXE32B

config MCUX_TOOLCHAIN_MDK_CPU_IDENTIFIER
    string
    default "MCXE32BMPB_core0" if MCUX_HW_DEVICE_PART_MCXE32BMPB

config MCUX_TOOLCHAIN_JLINK_CPU_IDENTIFIER
    string
    default "MCXE32B_core0" if MCUX_HW_DEVICE_ID_MCXE32B
```

## MCXL/MCXL142/Kconfig.chip
```kconfig
config MCUX_HW_SOC_MULTICORE_DEVICE
    bool
    default y

config MCUX_HW_DEVICE_CORE
    string
    default "MCXL142"

config MCUX_HW_SOC_SERIES_MCX
    bool
    default y

# device related

config MCUX_HW_DEVICE_ID_MCXL142xxx
    bool

choice
    prompt "Device MCXL142 Part"
    config MCUX_HW_DEVICE_PART_MCXL142VDH
    bool "Device part MCXL142VDH"
    select MCUX_HW_DEVICE_ID_MCXL142xxx
    config MCUX_HW_DEVICE_PART_MCXL142VLL
    bool "Device part MCXL142VLL"
    select MCUX_HW_DEVICE_ID_MCXL142xxx
endchoice

config MCUX_HW_DEVICE_ID
    string
    default "MCXL142" if MCUX_HW_DEVICE_ID_MCXL142xxx

config MCUX_HW_DEVICE_PART
    string
    default "MCXL142VDH" if MCUX_HW_DEVICE_PART_MCXL142VDH
    default "MCXL142VLL" if MCUX_HW_DEVICE_PART_MCXL142VLL

# For chipmodel generated files
config MCUX_TOOLCHAIN_LINKER_DEVICE_PREFIX
    string
    default "MCXL142" if MCUX_HW_DEVICE_ID_MCXL142xxx

config MCUX_TOOLCHAIN_MCUX_STARTUP
    string
    default "mcxl142"

# Toolchain related

config MCUX_TOOLCHAIN_IAR_CPU_IDENTIFIER
    string
    default "MCXL142_M33" if MCUX_HW_DEVICE_ID_MCXL142xxx

config MCUX_TOOLCHAIN_MDK_CPU_IDENTIFIER
    string
    default "MCXL142VDH" if MCUX_HW_DEVICE_PART_MCXL142VDH
    default "MCXL142VLL" if MCUX_HW_DEVICE_PART_MCXL142VLL

config MCUX_TOOLCHAIN_JLINK_CPU_IDENTIFIER
    string
    default "MCXL142_M33" if MCUX_HW_DEVICE_ID_MCXL142xxx

# ip information
config MCUX_HW_IP_DriverType_ARM
    bool
    default y
    depends on MCUX_HW_DEVICE_ID_MCXL142xxx

config MCUX_HW_IP_DriverType_ATX
    bool
    default y
    depends on MCUX_HW_DEVICE_ID_MCXL142xxx

config MCUX_HW_IP_DriverType_CORE
    bool
    default y
    depends on MCUX_HW_DEVICE_ID_MCXL142xxx

config MCUX_HW_IP_DriverType_DBGMB
    bool
    default y
    depends on MCUX_HW_DEVICE_ID_MCXL142xxx

config MCUX_HW_IP_DriverType_FMC
    bool
    default y
    depends on MCUX_HW_DEVICE_ID_MCXL142xxx

config MCUX_HW_IP_DriverType_FMU
    bool
    default y
    depends on MCUX_HW_DEVICE_ID_MCXL142xxx

config MCUX_HW_IP_DriverType_GPIO
    bool
    default y
    depends on MCUX_HW_DEVICE_ID_MCXL142xxx

config MCUX_HW_IP_DriverType_INPUTMUX
    bool
    default y
    depends on MCUX_HW_DEVICE_ID_MCXL142xxx

config MCUX_HW_IP_DriverType_JTAG
    bool
    default y
    depends on MCUX_HW_DEVICE_ID_MCXL142xxx

config MCUX_HW_IP_DriverType_AON_LPADC
    bool
    default y
    depends on MCUX_HW_DEVICE_ID_MCXL142xxx

config MCUX_HW_IP_DriverType_LPACMP
    bool
    default y
    depends on MCUX_HW_DEVICE_ID_MCXL142xxx

config MCUX_HW_IP_DriverType_LPC_SYSCON
    bool
    default y
    depends on MCUX_HW_DEVICE_ID_MCXL142xxx

config MCUX_HW_IP_DriverType_LPI2C
    bool
    default y
    depends on MCUX_HW_DEVICE_ID_MCXL142xxx

config MCUX_HW_IP_DriverType_LPTMR
    bool
    default y
    depends on MCUX_HW_DEVICE_ID_MCXL142xxx

config MCUX_HW_IP_DriverType_LPUART
    bool
    default y
    depends on MCUX_HW_DEVICE_ID_MCXL142xxx

config MCUX_HW_IP_DriverType_MRCC
    bool
    default y
    depends on MCUX_HW_DEVICE_ID_MCXL142xxx

config MCUX_HW_IP_DriverType_MU_1
    bool
    default y
    depends on MCUX_HW_DEVICE_ID_MCXL142xxx

config MCUX_HW_IP_DriverType_PORT
    bool
    default y
    depends on MCUX_HW_DEVICE_ID_MCXL142xxx

config MCUX_HW_IP_DriverType_SCG
    bool
    default y
    depends on MCUX_HW_DEVICE_ID_MCXL142xxx

config MCUX_HW_IP_DriverType_SMM
    bool
    default y
    depends on MCUX_HW_DEVICE_ID_MCXL142xxx

config MCUX_HW_IP_DriverType_SWD
    bool
    default y
    depends on MCUX_HW_DEVICE_ID_MCXL142xxx

config MCUX_HW_IP_DriverType_TMR_1
    bool
    default y
    depends on MCUX_HW_DEVICE_ID_MCXL142xxx

config MCUX_HW_IP_DriverType_PMIC
    bool
    default y
    depends on MCUX_HW_DEVICE_ID_MCXL142xxx

config MCUX_HW_IP_DriverType_RTC_ANALOG
    bool
    default y
    depends on MCUX_HW_DEVICE_ID_MCXL142xxx

config MCUX_HW_IP_DriverType_TRNG
    bool
    default y
    depends on MCUX_HW_DEVICE_ID_MCXL142xxx
```

## MCXL/MCXL142/drivers/Kconfig
```kconfig
# Copyright 2024 NXP
# All rights reserved.
#
# SPDX-License-Identifier: BSD-3-Clause

menu "Device specific drivers configuration"

    config MCUX_COMPONENT_driver.edma_soc
         bool "Use driver edma_soc"
         default n

    config MCUX_COMPONENT_driver.inputmux_connections
         bool "Use driver inputmux_connections"
         default y

    config MCUX_COMPONENT_driver.romapi
         bool "Use driver romapi"
         default y

endmenu
```
