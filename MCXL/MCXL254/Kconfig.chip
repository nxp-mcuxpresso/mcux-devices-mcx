## MCXL/MCXL254/Kconfig.chip
```kconfig
config MCUX_HW_SOC_MULTICORE_DEVICE
    bool
    default y

config MCUX_HW_DEVICE_CORE
    string
    default "MCXL254"

config MCUX_HW_SOC_SERIES_MCX
    bool
    default y

# device related

config MCUX_HW_DEVICE_ID_MCXL254xxx
    bool

choice
    prompt "Device MCXL254 Part"
    config MCUX_HW_DEVICE_PART_MCXL254VDF
    bool "Device part MCXL254VDF"
    select MCUX_HW_DEVICE_ID_MCXL254xxx
    config MCUX_HW_DEVICE_PART_MCXL254VLL
    bool "Device part MCXL254VLL"
    select MCUX_HW_DEVICE_ID_MCXL254xxx
endchoice

config MCUX_HW_DEVICE_ID
    string
    default "MCXL254xxx" if MCUX_HW_DEVICE_ID_MCXL254xxx

config MCUX_HW_DEVICE_PART
    string
    default "MCXL254VDF" if MCUX_HW_DEVICE_PART_MCXL254VDF
    default "MCXL254VLL" if MCUX_HW_DEVICE_PART_MCXL254VLL

# For chipmodel generated files
config MCUX_TOOLCHAIN_LINKER_DEVICE_PREFIX
    string
    default "MCXL254" if MCUX_HW_DEVICE_ID_MCXL254xxx

config MCUX_TOOLCHAIN_MCUX_STARTUP
    string
    default "mcxl254"

# Toolchain related

config MCUX_TOOLCHAIN_IAR_CPU_IDENTIFIER
    string
    default "MCXL254xxx" if MCUX_HW_DEVICE_ID_MCXL254xxx

config MCUX_TOOLCHAIN_MDK_CPU_IDENTIFIER
    string
    default "MCXL254VDF" if MCUX_HW_DEVICE_PART_MCXL254VDF
    default "MCXL254VLL" if MCUX_HW_DEVICE_PART_MCXL254VLL

config MCUX_TOOLCHAIN_JLINK_CPU_IDENTIFIER
    string
    default "MCXL254xxx" if MCUX_HW_DEVICE_ID_MCXL254xxx

# ip information
config MCUX_HW_IP_DriverType_ARM
    bool
    default y
    depends on MCUX_HW_DEVICE_ID_MCXL254xxx

config MCUX_HW_IP_DriverType_ATX
    bool
    default y
    depends on MCUX_HW_DEVICE_ID_MCXL254xxx

config MCUX_HW_IP_DriverType_CORE
    bool
    default y
    depends on MCUX_HW_DEVICE_ID_MCXL254xxx

config MCUX_HW_IP_DriverType_DBGMB
    bool
    default y
    depends on MCUX_HW_DEVICE_ID_MCXL254xxx

config MCUX_HW_IP_DriverType_FMC
    bool
    default y
    depends on MCUX_HW_DEVICE_ID_MCXL254xxx

config MCUX_HW_IP_DriverType_FMU
    bool
    default y
    depends on MCUX_HW_DEVICE_ID_MCXL254xxx

config MCUX_HW_IP_DriverType_GPIO
    bool
    default y
    depends on MCUX_HW_DEVICE_ID_MCXL254xxx

config MCUX_HW_IP_DriverType_INPUTMUX
    bool
    default y
    depends on MCUX_HW_DEVICE_ID_MCXL254xxx

config MCUX_HW_IP_DriverType_JTAG
    bool
    default y
    depends on MCUX_HW_DEVICE_ID_MCXL254xxx

config MCUX_HW_IP_DriverType_AON_LPADC
    bool
    default y
    depends on MCUX_HW_DEVICE_ID_MCXL254xxx

config MCUX_HW_IP_DriverType_LPACMP
    bool
    default y
    depends on MCUX_HW_DEVICE_ID_MCXL254xxx

config MCUX_HW_IP_DriverType_LPC_SYSCON
    bool
    default y
    depends on MCUX_HW_DEVICE_ID_MCXL254xxx

config MCUX_HW_IP_DriverType_LPI2C
    bool
    default y
    depends on MCUX_HW_DEVICE_ID_MCXL254xxx

config MCUX_HW_IP_DriverType_LPTMR
    bool
    default y
    depends on MCUX_HW_DEVICE_ID_MCXL254xxx

config MCUX_HW_IP_DriverType_LPUART
    bool
    default y
    depends on MCUX_HW_DEVICE_ID_MCXL254xxx

config MCUX_HW_IP_DriverType_MRCC
    bool
    default y
    depends on MCUX_HW_DEVICE_ID_MCXL254xxx

config MCUX_HW_IP_DriverType_MU_1
    bool
    default y
    depends on MCUX_HW_DEVICE_ID_MCXL254xxx

config MCUX_HW_IP_DriverType_PORT
    bool
    default y
    depends on MCUX_HW_DEVICE_ID_MCXL254xxx

config MCUX_HW_IP_DriverType_SCG
    bool
    default y
    depends on MCUX_HW_DEVICE_ID_MCXL254xxx

config MCUX_HW_IP_DriverType_SMM
    bool
    default y
    depends on MCUX_HW_DEVICE_ID_MCXL254xxx

config MCUX_HW_IP_DriverType_SWD
    bool
    default y
    depends on MCUX_HW_DEVICE_ID_MCXL254xxx

config MCUX_HW_IP_DriverType_TMR_1
    bool
    default y
    depends on MCUX_HW_DEVICE_ID_MCXL254xxx

config MCUX_HW_IP_DriverType_KPP
    bool
    default y
    depends on MCUX_HW_DEVICE_ID_MCXL254xxx

config MCUX_HW_IP_DriverType_SLCD_SPLIT
    bool
    default y
    depends on MCUX_HW_DEVICE_ID_MCXL254xxx

config MCUX_HW_IP_DriverType_PMIC
    bool
    default y
    depends on MCUX_HW_DEVICE_ID_MCXL254xxx

config MCUX_HW_IP_DriverType_RTC_ANALOG
    bool
    default y
    depends on MCUX_HW_DEVICE_ID_MCXL254xxx

config MCUX_HW_IP_DriverType_LPCMP
    bool
    default y
    depends on MCUX_HW_DEVICE_ID_MCXL254xxx

config MCUX_HW_IP_DriverType_TRNG
    bool
    default y
    depends on MCUX_HW_DEVICE_ID_MCXL254xxx
```

## MCXL/MCXL254/cm0plus/Kconfig.chip
```kconfig
# Copyright 2024-2025 NXP
# All rights reserved.
#
# SPDX-License-Identifier: BSD-3-Clause
# core related
config MCUX_HW_CORE
    string
    default "cm0p"

config MCUX_HW_CORE_CM0P
    bool
    default y

config MCUX_HW_CORE_ID
    string
    default "cm0plus"

config MCUX_HW_CORE_ID_CM0PLUS
    bool
    default y

config MCUX_HW_DEVICE_CORE
    string
    default "MCXL254_cm0plus"

config MCUX_HW_FPU
    string
    default "NO_FPU"

config MCUX_HW_FPU_TYPE
    string
    default "no_fpu"

config MCUX_HW_INT_PRIO_BITS
    int
    default 3

config MCUX_TOOLCHAIN_MCUX_STARTUP
    string
    default "mcxl254_cm0plus"

config MCUX_TOOLCHAIN_LINKER_DEVICE_PREFIX
    string
    default "MCXL254_cm0plus"

config MCUX_TOOLCHAIN_IAR_CPU_IDENTIFIER
    string
    default "MCXL254_M0P"

config MCUX_TOOLCHAIN_MDK_CPU_IDENTIFIER
    string
    default "MCXL254VDF:cm0plus" if MCUX_HW_DEVICE_PART_MCXL254VDF
    default "MCXL254VLL:cm0plus" if MCUX_HW_DEVICE_PART_MCXL254VLL

config MCUX_TOOLCHAIN_JLINK_CPU_IDENTIFIER
    string
    default "MCXL254_M0P"
```

## MCXL/MCXL254/cm33/Kconfig
```kconfig
# Copyright 2024-2025 NXP
# All rights reserved.
#
# SPDX-License-Identifier: BSD-3-Clause

config MCUX_HW_DEVICE_MCXL254_CORE_ID_CM33
    bool
    default y

#FIXME: cache?
#    imply MCUX_COMPONENT_driver.cache_xcache if MCUX_PRJSEG_module.device.suite

rsource "Kconfig.chip"
rsource "Kconfig.defconfig"
#rsource "../xip/Kconfig" FIXME do we need xip?
```

## MCXL/MCXL254/cm33/Kconfig.chip
```kconfig
# Copyright 2024-2025 NXP
# All rights reserved.
#
# SPDX-License-Identifier: BSD-3-Clause

# core related
config MCUX_HW_CORE
    string
    default "cm33"

config MCUX_HW_CORE_CM33
    bool
    default y

config MCUX_HW_CORE_ID
    string
    default "cm33"

config MCUX_HW_CORE_ID_CM33
    bool
    default y

config MCUX_HW_DEVICE_CORE
    string
    default "MCXL254_cm33"

config MCUX_HW_FPU
    string
    default "SP_FPU"

config MCUX_HW_FPU_TYPE
    string
    default "fpv5_sp"

config MCUX_HW_FPV5_SP
    bool
    default y

config MCUX_HW_INT_PRIO_BITS
    int
    default 3

config MCUX_HW_DSP
    bool
    default y

config MCUX_HW_SAU
    bool
    default y

config MCUX_TOOLCHAIN_MCUX_STARTUP
    string
    default "mcxl254_cm33"

config MCUX_TOOLCHAIN_LINKER_DEVICE_PREFIX
    string
    default "MCXL254_cm33"

config MCUX_TOOLCHAIN_IAR_CPU_IDENTIFIER
    string
    default "MCXL254xxx_M33"

config MCUX_TOOLCHAIN_MDK_CPU_IDENTIFIER
    string
    default "MCXL254VDF:cm33" if MCUX_HW_DEVICE_PART_MCXL254VDF
    default "MCXL254VLL:cm33" if MCUX_HW_DEVICE_PART_MCXL254VLL

config MCUX_TOOLCHAIN_JLINK_CPU_IDENTIFIER
    string
    default "MCXL254xxx_M33"


# CM33 only ip information

config MCUX_HW_IP_DriverType_AOI
    bool
    default y
    depends on MCUX_HW_DEVICE_ID_MCXL254xxx

config MCUX_HW_IP_DriverType_CRC
    bool
    default y
    depends on MCUX_HW_DEVICE_ID_MCXL254xxx

config MCUX_HW_IP_DriverType_GLIKEY
    bool
    default y
    depends on MCUX_HW_DEVICE_ID_MCXL254xxx

config MCUX_HW_IP_DriverType_LPADC
    bool
    default y
    depends on MCUX_HW_DEVICE_ID_MCXL254xxx

config MCUX_HW_IP_DriverType_CDOG
    bool
    default y
    depends on MCUX_HW_DEVICE_ID_MCXL254xxx

config MCUX_HW_IP_DriverType_EDMA3
    bool
    default y
    depends on MCUX_HW_DEVICE_ID_MCXL254xxx

config MCUX_HW_IP_DriverType_FREQME
    bool
    default y
    depends on MCUX_HW_DEVICE_ID_MCXL254xxx

config MCUX_HW_IP_DriverType_ERM
    bool
    default y
    depends on MCUX_HW_DEVICE_ID_MCXL254xxx

config MCUX_HW_IP_DriverType_OSTIMER
    bool
    default y
    depends on MCUX_HW_DEVICE_ID_MCXL254xxx

config MCUX_HW_IP_DriverType_CTIMER
    bool
    default y
    depends on MCUX_HW_DEVICE_ID_MCXL254xxx

config MCUX_HW_IP_DriverType_MCX_CMC
    bool
    default y
    depends on MCUX_HW_DEVICE_ID_MCXL254xxx

config MCUX_HW_IP_DriverType_TRDC_1
    bool
    default y
    depends on MCUX_HW_DEVICE_ID_MCXL254xxx

config MCUX_HW_IP_DriverType_LPSPI
    bool
    default y
    depends on MCUX_HW_DEVICE_ID_MCXL254xxx

config MCUX_HW_IP_DriverType_WWDT
    bool
    default y
    depends on MCUX_HW_DEVICE_ID_MCXL254xxx

config MCUX_HW_IP_DriverType_UTICK
    bool
    default y
    depends on MCUX_HW_DEVICE_ID_MCXL254xxx

config MCUX_HW_IP_DriverType_WUU
    bool
    default y
    depends on MCUX_HW_DEVICE_ID_MCXL254xxx
```

## MCXL/MCXL255/Kconfig.chip
```kconfig
# Copyright 2024-2025 NXP
# All rights reserved.
#
# SPDX-License-Identifier: BSD-3-Clause

config MCUX_HW_SOC_MULTICORE_DEVICE
    bool
    default y

config MCUX_HW_DEVICE_CORE
    string
    default "MCXL255"

config MCUX_HW_SOC_SERIES_MCX
    bool
    default y

# device related

config MCUX_HW_DEVICE_ID_MCXL255xxx
    bool

choice
    prompt "Device MCXL255 Part"
    config MCUX_HW_DEVICE_PART_MCXL255VDF
    bool "Device part MCXL255VDF"
    select MCUX_HW_DEVICE_ID_MCXL255xxx
    config MCUX_HW_DEVICE_PART_MCXL255VLL
    bool "Device part MCXL255VLL"
    select MCUX_HW_DEVICE_ID_MCXL255xxx
endchoice

config MCUX_HW_DEVICE_ID
    string
    default "MCXL255xxx" if MCUX_HW_DEVICE_ID_MCXL255xxx

config MCUX_HW_DEVICE_PART
    string
    default "MCXL255VDF" if MCUX_HW_DEVICE_PART_MCXL255VDF
    default "MCXL255VLL" if MCUX_HW_DEVICE_PART_MCXL255VLL

# For chipmodel generated files
config MCUX_TOOLCHAIN_LINKER_DEVICE_PREFIX
    string
    default "MCXL255" if MCUX_HW_DEVICE_ID_MCXL255xxx

config MCUX_TOOLCHAIN_MCUX_STARTUP
    string
    default "mcxl255"

# Toolchain related

config MCUX_TOOLCHAIN_IAR_CPU_IDENTIFIER
    string
    default "MCXL255xxx" if MCUX_HW_DEVICE_ID_MCXL255xxx

config MCUX_TOOLCHAIN_MDK_CPU_IDENTIFIER
    string
    default "MCXL255VDF" if MCUX_HW_DEVICE_PART_MCXL255VDF
    default "MCXL255VLL" if MCUX_HW_DEVICE_PART_MCXL255VLL

config MCUX_TOOLCHAIN_JLINK_CPU_IDENTIFIER
    string
    default "MCXL255xxx" if MCUX_HW_DEVICE_ID_MCXL255xxx

# ip information
config MCUX_HW_IP_DriverType_ARM
    bool
    default y
    depends on MCUX_HW_DEVICE_ID_MCXL255xxx

config MCUX_HW_IP_DriverType_ATX
    bool
    default y
    depends on MCUX_HW_DEVICE_ID_MCXL255xxx

config MCUX_HW_IP_DriverType_CORE
    bool
    default y
    depends on MCUX_HW_DEVICE_ID_MCXL255xxx

config MCUX_HW_IP_DriverType_DBGMB
    bool
    default y
    depends on MCUX_HW_DEVICE_ID_MCXL255xxx

config MCUX_HW_IP_DriverType_FMC
    bool
    default y
    depends on MCUX_HW_DEVICE_ID_MCXL255xxx

config MCUX_HW_IP_DriverType_FMU
    bool
    default y
    depends on MCUX_HW_DEVICE_ID_MCXL255xxx

config MCUX_HW_IP_DriverType_GPIO
    bool
    default y
    depends on MCUX_HW_DEVICE_ID_MCXL255xxx

config MCUX_HW_IP_DriverType_INPUTMUX
    bool
    default y
    depends on MCUX_HW_DEVICE_ID_MCXL255xxx

config MCUX_HW_IP_DriverType_JTAG
    bool
    default y
    depends on MCUX_HW_DEVICE_ID_MCXL255xxx

config MCUX_HW_IP_DriverType_AON_LPADC
    bool
    default y
    depends on MCUX_HW_DEVICE_ID_MCXL255xxx

config MCUX_HW_IP_DriverType_LPACMP
    bool
    default y
    depends on MCUX_HW_DEVICE_ID_MCXL255xxx

config MCUX_HW_IP_DriverType_LPC_SYSCON
    bool
    default y
    depends on MCUX_HW_DEVICE_ID_MCXL255xxx

config MCUX_HW_IP_DriverType_LPI2C
    bool
    default y
    depends on MCUX_HW_DEVICE_ID_MCXL255xxx

config MCUX_HW_IP_DriverType_LPTMR
    bool
    default y
    depends on MCUX_HW_DEVICE_ID_MCXL255xxx

config MCUX_HW_IP_DriverType_LPUART
    bool
    default y
    depends on MCUX_HW_DEVICE_ID_MCXL255xxx

config MCUX_HW_IP_DriverType_MRCC
    bool
    default y
    depends on MCUX_HW_DEVICE_ID_MCXL255xxx

config MCUX_HW_IP_DriverType_MU_1
    bool
    default y
    depends on MCUX_HW_DEVICE_ID_MCXL255xxx

config MCUX_HW_IP_DriverType_PORT
    bool
    default y
    depends on MCUX_HW_DEVICE_ID_MCXL255xxx

config MCUX_HW_IP_DriverType_SCG
    bool
    default y
    depends on MCUX_HW_DEVICE_ID_MCXL255xxx

config MCUX_HW_IP_DriverType_SMM
    bool
    default y
    depends on MCUX_HW_DEVICE_ID_MCXL255xxx

config MCUX_HW_IP_DriverType_SWD
    bool
    default y
    depends on MCUX_HW_DEVICE_ID_MCXL255xxx

config MCUX_HW_IP_DriverType_TMR_1
    bool
    default y
    depends on MCUX_HW_DEVICE_ID_MCXL255xxx

config MCUX_HW_IP_DriverType_KPP
    bool
    default y
    depends on MCUX_HW_DEVICE_ID_MCXL255xxx

config MCUX_HW_IP_DriverType_SLCD_SPLIT
    bool
    default y
    depends on MCUX_HW_DEVICE_ID_MCXL255xxx

config MCUX_HW_IP_DriverType_PMIC
    bool
    default y
    depends on MCUX_HW_DEVICE_ID_MCXL255xxx

config MCUX_HW_IP_DriverType_RTC_ANALOG
    bool
    default y
    depends on MCUX_HW_DEVICE_ID_MCXL255xxx

config MCUX_HW_IP_DriverType_LPCMP
    bool
    default y
    depends on MCUX_HW_DEVICE_ID_MCXL255xxx

# CM33 only ip information - temporary workaround. Will be moved to cm33/kconfig.chip in the future.

config MCUX_HW_IP_DriverType_AOI
    bool
    default y
    depends on MCUX_HW_DEVICE_ID_MCXL255xxx

config MCUX_HW_IP_DriverType_CRC
    bool
    default y
    depends on MCUX_HW_DEVICE_ID_MCXL255xxx

config MCUX_HW_IP_DriverType_GLIKEY
    bool
    default y
    depends on MCUX_HW_DEVICE_ID_MCXL255xxx

config MCUX_HW_IP_DriverType_LPADC
    bool
    default y
    depends on MCUX_HW_DEVICE_ID_MCXL255xxx

config MCUX_HW_IP_DriverType_CDOG
    bool
    default y
    depends on MCUX_HW_DEVICE_ID_MCXL255xxx

config MCUX_HW_IP_DriverType_EDMA3
    bool
    default y
    depends on MCUX_HW_DEVICE_ID_MCXL255xxx

config MCUX_HW_IP_DriverType_FREQME
    bool
    default y
    depends on MCUX_HW_DEVICE_ID_MCXL255xxx

config MCUX_HW_IP_DriverType_ERM
    bool
    default y
    depends on MCUX_HW_DEVICE_ID_MCXL255xxx

config MCUX_HW_IP_DriverType_OSTIMER
    bool
    default y
    depends on MCUX_HW_DEVICE_ID_MCXL255xxx

config MCUX_HW_IP_DriverType_CTIMER
    bool
    default y
    depends on MCUX_HW_DEVICE_ID_MCXL255xxx

config MCUX_HW_IP_DriverType_MCX_CMC
    bool
    default y
    depends on MCUX_HW_DEVICE_ID_MCXL255xxx

config MCUX_HW_IP_DriverType_TRDC_1
    bool
    default y
    depends on MCUX_HW_DEVICE_ID_MCXL255xxx

config MCUX_HW_IP_DriverType_LPSPI
    bool
    default y
    depends on MCUX_HW_DEVICE_ID_MCXL255xxx

config MCUX_HW_IP_DriverType_WWDT
    bool
    default y
    depends on MCUX_HW_DEVICE_ID_MCXL255xxx

config MCUX_HW_IP_DriverType_UTICK
    bool
    default y
    depends on MCUX_HW_DEVICE_ID_MCXL255xxx

config MCUX_HW_IP_DriverType_WUU
    bool
    default y
    depends on MCUX_HW_DEVICE_ID_MCXL255xxx
```

## MCXL/MCXL255/cm0plus/Kconfig
```kconfig
config MCUX_HW_DEVICE_MCXL255_CORE_ID_CM0P
    bool
    default y

#    imply MCUX_COMPONENT_driver.cache_armv7_m0 if MCUX_PRJSEG_module.device.suite

rsource "Kconfig.chip"
rsource "Kconfig.defconfig"
```

## MCXL/MCXL255/cm33/Kconfig
```kconfig
config MCUX_HW_DEVICE_MCXL255_CORE_ID_CM33
    bool
    default y

#FIXME: cache?
#    imply MCUX_COMPONENT_driver.cache_xcache if MCUX_PRJSEG_module.device.suite

rsource "Kconfig.chip"
rsource "Kconfig.defconfig"
#rsource "../xip/Kconfig" FIXME do we need xip?
```
