## MCXN/MCXN536/Kconfig.chip
```kconfig
# Copyright 2024 NXP
#
# SPDX-License-Identifier: BSD-3-Clause

# device related

config MCUX_HW_DEVICE_ID_MCXN536
    bool

choice MCUX_HW_DEVICE_PART_MCXN536
    prompt "Device MCXN536 Part"
    config MCUX_HW_DEVICE_PART_MCXN536VAB
    bool "MCXN536VAB"
    select MCUX_HW_DEVICE_ID_MCXN536
    config MCUX_HW_DEVICE_PART_MCXN536VDF
    bool "MCXN536VDF"
    select MCUX_HW_DEVICE_ID_MCXN536
    config MCUX_HW_DEVICE_PART_MCXN536VKL
    bool "MCXN536VKL"
    select MCUX_HW_DEVICE_ID_MCXN536
    config MCUX_HW_DEVICE_PART_MCXN536VPB
    bool "MCXN536VPB"
    select MCUX_HW_DEVICE_ID_MCXN536
endchoice

config MCUX_HW_DEVICE_ID
    string
    default "MCXN536" if MCUX_HW_DEVICE_ID_MCXN536

config MCUX_HW_DEVICE_PART
    string
    default "MCXN536VAB" if MCUX_HW_DEVICE_PART_MCXN536VAB
    default "MCXN536VDF" if MCUX_HW_DEVICE_PART_MCXN536VDF
    default "MCXN536VKL" if MCUX_HW_DEVICE_PART_MCXN536VKL
    default "MCXN536VPB" if MCUX_HW_DEVICE_PART_MCXN536VPB

config MCUX_HW_IP_DriverType_FLEXIO_MCULCD
    bool
    default y
    depends on MCUX_HW_DEVICE_ID_MCXN536

# ip information
config MCUX_HW_IP_DriverType_AHBSC
    bool
    default y
    depends on MCUX_HW_DEVICE_ID_MCXN536

config MCUX_HW_IP_DriverType_CACHE64_CTRL
    bool
    default y
    depends on MCUX_HW_DEVICE_ID_MCXN536

config MCUX_HW_IP_DriverType_CACHE64_POLSEL
    bool
    default y
    depends on MCUX_HW_DEVICE_ID_MCXN536

config MCUX_HW_IP_DriverType_CDOG
    bool
    default y
    depends on MCUX_HW_DEVICE_ID_MCXN536

config MCUX_HW_IP_DriverType_CRC
    bool
    default y
    depends on MCUX_HW_DEVICE_ID_MCXN536

config MCUX_HW_IP_DriverType_CTIMER
    bool
    default y
    depends on MCUX_HW_DEVICE_ID_MCXN536

config MCUX_HW_IP_DriverType_DBGMB
    bool
    default y
    depends on MCUX_HW_DEVICE_ID_MCXN536

config MCUX_HW_IP_DriverType_DIGTMP
    bool
    default y
    depends on MCUX_HW_DEVICE_ID_MCXN536

config MCUX_HW_IP_DriverType_EDMA3
    bool
    default y
    depends on MCUX_HW_DEVICE_ID_MCXN536

config MCUX_HW_IP_DriverType_EIM
    bool
    default y
    depends on MCUX_HW_DEVICE_ID_MCXN536

config MCUX_HW_IP_DriverType_ERM
    bool
    default y
    depends on MCUX_HW_DEVICE_ID_MCXN536

config MCUX_HW_IP_DriverType_EWM
    bool
    default y
    depends on MCUX_HW_DEVICE_ID_MCXN536

config MCUX_HW_IP_DriverType_FLEXCAN
    bool
    default y
    depends on MCUX_HW_DEVICE_ID_MCXN536

config MCUX_HW_IP_DriverType_FLEXIO
    bool
    default y
    depends on MCUX_HW_DEVICE_ID_MCXN536

config MCUX_HW_IP_DriverType_FLEXSPI
    bool
    default y
    depends on MCUX_HW_DEVICE_ID_MCXN536

config MCUX_HW_IP_DriverType_FLEXSPI_IPED
    bool
    default y
    depends on MCUX_HW_DEVICE_ID_MCXN536

config MCUX_HW_IP_DriverType_FMC
    bool
    default y
    depends on MCUX_HW_DEVICE_ID_MCXN536

config MCUX_HW_IP_DriverType_FMU
    bool
    default y
    depends on MCUX_HW_DEVICE_ID_MCXN536

config MCUX_HW_IP_DriverType_FREQME
    bool
    default y
    depends on MCUX_HW_DEVICE_ID_MCXN536

config MCUX_HW_IP_DriverType_GDET
    bool
    default y
    depends on MCUX_HW_DEVICE_ID_MCXN536

config MCUX_HW_IP_DriverType_GPIO
    bool
    default y
    depends on MCUX_HW_DEVICE_ID_MCXN536

config MCUX_HW_IP_DriverType_I3C
    bool
    default y
    depends on MCUX_HW_DEVICE_ID_MCXN536

config MCUX_HW_IP_DriverType_INPUTMUX
    bool
    default y
    depends on MCUX_HW_DEVICE_ID_MCXN536

config MCUX_HW_IP_DriverType_INTM
    bool
    default y
    depends on MCUX_HW_DEVICE_ID_MCXN536

config MCUX_HW_IP_DriverType_IPCSS
    bool
    default y
    depends on MCUX_HW_DEVICE_ID_MCXN536

config MCUX_HW_IP_DriverType_ITRC
    bool
    default y
    depends on MCUX_HW_DEVICE_ID_MCXN536

config MCUX_HW_IP_DriverType_LPADC
    bool
    default y
    depends on MCUX_HW_DEVICE_ID_MCXN536

config MCUX_HW_IP_DriverType_LPCMP
    bool
    default y
    depends on MCUX_HW_DEVICE_ID_MCXN536

config MCUX_HW_IP_DriverType_LPDAC
    bool
    default y
    depends on MCUX_HW_DEVICE_ID_MCXN536

config MCUX_HW_IP_DriverType_LPFLEXCOMM
    bool
    default y
    depends on MCUX_HW_DEVICE_ID_MCXN536

config MCUX_HW_IP_DriverType_LPFLEXCOMM_LPI2C
    bool
    default y
    depends on MCUX_HW_DEVICE_ID_MCXN536

config MCUX_HW_IP_DriverType_LPFLEXCOMM_LPSPI
    bool
    default y
    depends on MCUX_HW_DEVICE_ID_MCXN536

config MCUX_HW_IP_DriverType_LPFLEXCOMM_LPUART
    bool
    default y
    depends on MCUX_HW_DEVICE_ID_MCXN536

config MCUX_HW_IP_DriverType_LPTMR
    bool
    default y
    depends on MCUX_HW_DEVICE_ID_MCXN536

config MCUX_HW_IP_DriverType_MAILBOX
    bool
    default y
    depends on MCUX_HW_DEVICE_ID_MCXN536

config MCUX_HW_IP_DriverType_MCX_CMC
    bool
    default y
    depends on MCUX_HW_DEVICE_ID_MCXN536

config MCUX_HW_IP_DriverType_MCX_SPC
    bool
    default y
    depends on MCUX_HW_DEVICE_ID_MCXN536

config MCUX_HW_IP_DriverType_MCX_VBAT
    bool
    default y
    depends on MCUX_HW_DEVICE_ID_MCXN536

config MCUX_HW_IP_DriverType_MRT
    bool
    default y
    depends on MCUX_HW_DEVICE_ID_MCXN536

config MCUX_HW_IP_DriverType_NPX
    bool
    default y
    depends on MCUX_HW_DEVICE_ID_MCXN536

config MCUX_HW_IP_DriverType_OPAMP
    bool
    default y
    depends on MCUX_HW_DEVICE_ID_MCXN536

config MCUX_HW_IP_DriverType_OSTIMER
    bool
    default y
    depends on MCUX_HW_DEVICE_ID_MCXN536

config MCUX_HW_IP_DriverType_OTPC
    bool
    default y
    depends on MCUX_HW_DEVICE_ID_MCXN536

config MCUX_HW_IP_DriverType_PDM
    bool
    default y
    depends on MCUX_HW_DEVICE_ID_MCXN536

config MCUX_HW_IP_DriverType_PINT
    bool
    default y
    depends on MCUX_HW_DEVICE_ID_MCXN536

config MCUX_HW_IP_DriverType_PKC
    bool
    default y
    depends on MCUX_HW_DEVICE_ID_MCXN536

config MCUX_HW_IP_DriverType_PORT
    bool
    default y
    depends on MCUX_HW_DEVICE_ID_MCXN536

config MCUX_HW_IP_DriverType_POWERQUAD
    bool
    default y
    depends on MCUX_HW_DEVICE_ID_MCXN536

config MCUX_HW_IP_DriverType_PUFCTRL
    bool
    default y
    depends on MCUX_HW_DEVICE_ID_MCXN536

config MCUX_HW_IP_DriverType_PUFV3
    bool
    default y
    depends on MCUX_HW_DEVICE_ID_MCXN536

config MCUX_HW_IP_DriverType_PWM
    bool
    default y
    depends on MCUX_HW_DEVICE_ID_MCXN536

config MCUX_HW_IP_DriverType_RTC_V2
    bool
    default y
    depends on MCUX_HW_DEVICE_ID_MCXN536

config MCUX_HW_IP_DriverType_SAI
    bool
    default y
    depends on MCUX_HW_DEVICE_ID_MCXN536

config MCUX_HW_IP_DriverType_SCG
    bool
    default y
    depends on MCUX_HW_DEVICE_ID_MCXN536

config MCUX_HW_IP_DriverType_SCTIMER
    bool
    default y
    depends on MCUX_HW_DEVICE_ID_MCXN536

config MCUX_HW_IP_DriverType_SEMA42
    bool
    default y
    depends on MCUX_HW_DEVICE_ID_MCXN536

config MCUX_HW_IP_DriverType_SINC
    bool
    default y
    depends on MCUX_HW_DEVICE_ID_MCXN536

config MCUX_HW_IP_DriverType_SMARTDMA
    bool
    default y
    depends on MCUX_HW_DEVICE_ID_MCXN536

config MCUX_HW_IP_DriverType_SWD
    bool
    default y
    depends on MCUX_HW_DEVICE_ID_MCXN536

config MCUX_HW_IP_DriverType_SYSCON_LPCAC
    bool
    default y
    depends on MCUX_HW_DEVICE_ID_MCXN536

config MCUX_HW_IP_DriverType_SYSPM
    bool
    default y
    depends on MCUX_HW_DEVICE_ID_MCXN536

config MCUX_HW_IP_DriverType_TRDC_1
    bool
    default y
    depends on MCUX_HW_DEVICE_ID_MCXN536

config MCUX_HW_IP_DriverType_TSI_V6
    bool
    default y
    depends on MCUX_HW_DEVICE_ID_MCXN536

config MCUX_HW_IP_DriverType_USBHSDCD
    bool
    default y
    depends on MCUX_HW_DEVICE_ID_MCXN536

config MCUX_HW_IP_DriverType_USBNC
    bool
    default y
    depends on MCUX_HW_DEVICE_ID_MCXN536

config MCUX_HW_IP_DriverType_USB_HOST_DEVICE_EHCI
    bool
    default y
    depends on MCUX_HW_DEVICE_ID_MCXN536

config MCUX_HW_IP_DriverType_USB_HOST_DEVICE_KHCI
    bool
    default y
    depends on MCUX_HW_DEVICE_ID_MCXN536

config MCUX_HW_IP_DriverType_USB_HSDCD
    bool
    default y
    depends on MCUX_HW_DEVICE_ID_MCXN536

config MCUX_HW_IP_DriverType_USB_PHY
    bool
    default y
    depends on MCUX_HW_DEVICE_ID_MCXN536

config MCUX_HW_IP_DriverType_USDHC
    bool
    default y
    depends on MCUX_HW_DEVICE_ID_MCXN536

config MCUX_HW_IP_DriverType_UTICK
    bool
    default y
    depends on MCUX_HW_DEVICE_ID_MCXN536

config MCUX_HW_IP_DriverType_VREF_1
    bool
    default y
    depends on MCUX_HW_DEVICE_ID_MCXN536

config MCUX_HW_IP_DriverType_WUU
    bool
    default y
    depends on MCUX_HW_DEVICE_ID_MCXN536

config MCUX_HW_IP_DriverType_WWDT
    bool
    default y
    depends on MCUX_HW_DEVICE_ID_MCXN536
```

## MCXN/MCXN537/cm33_core1/Kconfig.chip
```kconfig
# Copyright 2024 NXP
# All rights reserved.
#
# SPDX-License-Identifier: BSD-3-Clause
# core related
config MCUX_HW_CORE
    string
    default "cm33"

config MCUX_HW_CORE_CM33
    bool
    default y

config MCUX_HW_CORE_ID
    string
    default "cm33_core1"

config MCUX_HW_CORE_ID_CM33_CORE1
    bool
    default y

config MCUX_HW_DEVICE_CORE
    string
    default "MCXN537_cm33_core1"

config MCUX_HW_FPU
    string
    default "NO_FPU"

config MCUX_HW_FPU_TYPE
    string
    default "no_fpu"

config MCUX_HW_NO_FPU
    bool
    default y

config MCUX_HW_INT_PRIO_BITS
    int
    default 3

config MCUX_HW_DSP
    bool
    default n

config MCUX_HW_SAU
    bool
    default n

config MCUX_HW_SOC_SERIES_MCX
    bool
    default y

# For chipmodel generated files
config MCUX_TOOLCHAIN_LINKER_DEVICE_PREFIX
    string
    default "MCXN537_cm33_core1" if MCUX_HW_DEVICE_ID_MCXN537

config MCUX_TOOLCHAIN_MCUX_STARTUP
    string
    default "mcxn537_cm33_core1"

# Toolchain related

config MCUX_TOOLCHAIN_IAR_CPU_IDENTIFIER
    string
    default "MCXN537_core1" if MCUX_HW_DEVICE_ID_MCXN537

config MCUX_TOOLCHAIN_MDK_CPU_IDENTIFIER
    string
    default "MCXN537VAB:cm33_core1" if MCUX_HW_DEVICE_PART_MCXN537VAB
    default "MCXN537VDF:cm33_core1" if MCUX_HW_DEVICE_PART_MCXN537VDF
    default "MCXN537VKL:cm33_core1" if MCUX_HW_DEVICE_PART_MCXN537VKL
    default "MCXN537VPB:cm33_core1" if MCUX_HW_DEVICE_PART_MCXN537VPB

config MCUX_TOOLCHAIN_JLINK_CPU_IDENTIFIER
    string
    default "MCXN537_M33_1" if MCUX_HW_DEVICE_ID_MCXN537
```

## MCXN/MCXN556S/cm33_core1/Kconfig.chip
```kconfig
# Copyright 2024 NXP
# All rights reserved.
#
# SPDX-License-Identifier: BSD-3-Clause
# core related
config MCUX_HW_CORE
    string
    default "cm33"

config MCUX_HW_CORE_CM33
    bool
    default y

config MCUX_HW_CORE_ID
    string
    default "cm33_core1"

config MCUX_HW_CORE_ID_CM33_CORE1
    bool
    default y

config MCUX_HW_DEVICE_CORE
    string
    default "MCXN556S_cm33_core1"

config MCUX_HW_FPU
    string
    default "NO_FPU"

config MCUX_HW_FPU_TYPE
    string
    default "no_fpu"

config MCUX_HW_NO_FPU
    bool
    default y

config MCUX_HW_INT_PRIO_BITS
    int
    default 3

config MCUX_HW_DSP
    bool
    default n

config MCUX_HW_SAU
    bool
    default n

config MCUX_HW_SOC_SERIES_MCX
    bool
    default y

# For chipmodel generated files
config MCUX_TOOLCHAIN_LINKER_DEVICE_PREFIX
    string
    default "MCXN556S_cm33_core1" if MCUX_HW_DEVICE_ID_MCXN556S

config MCUX_TOOLCHAIN_MCUX_STARTUP
    string
    default "mcxn556s_cm33_core1"

# Toolchain related

config MCUX_TOOLCHAIN_IAR_CPU_IDENTIFIER
    string
    default "MCXN556S_core1" if MCUX_HW_DEVICE_ID_MCXN556S

config MCUX_TOOLCHAIN_MDK_CPU_IDENTIFIER
    string
    default "MCXN556SCDF:cm33_core1" if MCUX_HW_DEVICE_PART_MCXN556SCDF

config MCUX_TOOLCHAIN_JLINK_CPU_IDENTIFIER
    string
    default "MCXN556S_M33_1" if MCUX_HW_DEVICE_ID_MCXN556S
```

## MCXN/MCXN556S/drivers/romapi/Kconfig
```kconfig
# Copyright 2025 NXP
#
# SPDX-License-Identifier: BSD-3-Clause

config MCUX_HAS_COMPONENT_driver.romapi
    bool
    default y

config MCUX_COMPONENT_driver.romapi
    bool "romapi"
    select MCUX_COMPONENT_driver.common
    select MCUX_COMPONENT_driver.mem_interface
    select MCUX_COMPONENT_driver.romapi_nboot
    select MCUX_COMPONENT_driver.runbootloader
    select MCUX_COMPONENT_driver.romapi_flashiap
    depends on MCUX_HAS_COMPONENT_driver.romapi

config MCUX_COMPONENT_driver.mem_interface
    bool "mem_interface"
    select MCUX_COMPONENT_driver.common
    select MCUX_COMPONENT_driver.romapi_nboot
    select MCUX_COMPONENT_driver.romapi_flashiap
    depends on MCUX_HAS_COMPONENT_driver.romapi

config MCUX_COMPONENT_driver.romapi_nboot
    bool "romapi_nboot"
    select MCUX_COMPONENT_driver.common
    depends on MCUX_HAS_COMPONENT_driver.romapi

config MCUX_COMPONENT_driver.runbootloader
    bool "runbootloader"
    select MCUX_COMPONENT_driver.common
    depends on MCUX_HAS_COMPONENT_driver.romapi

config MCUX_COMPONENT_driver.romapi_flashiap
    bool "romapi_flashiap"
    select MCUX_COMPONENT_driver.common
    depends on MCUX_HAS_COMPONENT_driver.romapi
```

## MCXN/MCXN947/drivers/romapi/Kconfig
```kconfig
# Copyright 2024 NXP
#
# SPDX-License-Identifier: BSD-3-Clause

config MCUX_HAS_COMPONENT_driver.romapi
    bool
    default y

config MCUX_COMPONENT_driver.romapi
    bool "romapi"
    select MCUX_COMPONENT_driver.common
    depends on MCUX_HAS_COMPONENT_driver.romapi

config MCUX_COMPONENT_driver.mem_interface
    bool "mem_interface"
    select MCUX_COMPONENT_driver.common
    depends on MCUX_HAS_COMPONENT_driver.romapi

config MCUX_COMPONENT_driver.romapi_nboot
    bool "romapi_nboot"
    select MCUX_COMPONENT_driver.common
    depends on MCUX_HAS_COMPONENT_driver.romapi

config MCUX_COMPONENT_driver.runbootloader
    bool "runbootloader"
    select MCUX_COMPONENT_driver.common
    depends on MCUX_HAS_COMPONENT_driver.romapi

config MCUX_COMPONENT_driver.romapi_flashiap
    bool "romapi_flashiap"
    select MCUX_COMPONENT_driver.common
    depends on MCUX_HAS_COMPONENT_driver.romapi
```
