## MCXC/MCXC162/Kconfig.chip
```kconfig
# Copyright 2025 NXP
#
# SPDX-License-Identifier: BSD-3-Clause

# core related
config MCUX_HW_CORE
    string
    default "cm23"

config MCUX_HW_CORE_CM23
    bool
    default y

config MCUX_HW_CORE_ID
    string
    default "cm23_core0"

config MCUX_HW_CORE_ID_CM23_CORE0
    bool
    default y

config MCUX_HW_DEVICE_CORE
    string
    default "MCXC162"

config MCUX_HW_FPU
    string
    default "NO_FPU"

config MCUX_HW_FPU_TYPE
    string
    default "no_fpu"

config MCUX_HW_NO_FPU
    bool
    default y

config MCUX_HW_INT_PRIO_BITS
    int
    default 2

config MCUX_HW_SAU
    bool
    default n

config MCUX_HW_SOC_SERIES_MCX
    bool
    default y

config MCUX_HW_SOC_SINGLECORE_DEVICE
    bool
    default y

# device related

config MCUX_HW_DEVICE_ID_MCXC162
    bool

choice MCUX_HW_DEVICE_PART_MCXC162
    prompt "Device MCXC162 Part"
    config MCUX_HW_DEVICE_PART_MCXC162VFG
    bool "MCXC162VFG"
    select MCUX_HW_DEVICE_ID_MCXC162
    config MCUX_HW_DEVICE_PART_MCXC162VFK
    bool "MCXC162VFK"
    select MCUX_HW_DEVICE_ID_MCXC162
    config MCUX_HW_DEVICE_PART_MCXC162VFM
    bool "MCXC162VFM"
    select MCUX_HW_DEVICE_ID_MCXC162
    config MCUX_HW_DEVICE_PART_MCXC162VFT
    bool "MCXC162VFT"
    select MCUX_HW_DEVICE_ID_MCXC162
    config MCUX_HW_DEVICE_PART_MCXC162VLF
    bool "MCXC162VLF"
    select MCUX_HW_DEVICE_ID_MCXC162
endchoice

config MCUX_HW_DEVICE_ID
    string
    default "MCXC162" if MCUX_HW_DEVICE_ID_MCXC162

config MCUX_HW_DEVICE_PART
    string
    default "MCXC162VFG" if MCUX_HW_DEVICE_PART_MCXC162VFG
    default "MCXC162VFK" if MCUX_HW_DEVICE_PART_MCXC162VFK
    default "MCXC162VFM" if MCUX_HW_DEVICE_PART_MCXC162VFM
    default "MCXC162VFT" if MCUX_HW_DEVICE_PART_MCXC162VFT
    default "MCXC162VLF" if MCUX_HW_DEVICE_PART_MCXC162VLF

# For chipmodel generated files
config MCUX_TOOLCHAIN_LINKER_DEVICE_PREFIX
    string
    default "MCXC162" if MCUX_HW_DEVICE_ID_MCXC162

config MCUX_TOOLCHAIN_MCUX_STARTUP
    string
    default "mcxc162"

# Toolchain related

config MCUX_TOOLCHAIN_IAR_CPU_IDENTIFIER
    string
    default "MCXC162" if MCUX_HW_DEVICE_ID_MCXC162

config MCUX_TOOLCHAIN_MDK_CPU_IDENTIFIER
    string
    default "MCXC162VFG" if MCUX_HW_DEVICE_PART_MCXC162VFG
    default "MCXC162VFK" if MCUX_HW_DEVICE_PART_MCXC162VFK
    default "MCXC162VFM" if MCUX_HW_DEVICE_PART_MCXC162VFM
    default "MCXC162VFT" if MCUX_HW_DEVICE_PART_MCXC162VFT
    default "MCXC162VLF" if MCUX_HW_DEVICE_PART_MCXC162VLF

config MCUX_TOOLCHAIN_JLINK_CPU_IDENTIFIER
    string
    default "MCXC162" if MCUX_HW_DEVICE_ID_MCXC162

# ip information
config MCUX_HW_IP_DriverType_CRC
    bool
    default y
    depends on MCUX_HW_DEVICE_ID_MCXC162

config MCUX_HW_IP_DriverType_CTIMER
    bool
    default y
    depends on MCUX_HW_DEVICE_ID_MCXC162

config MCUX_HW_IP_DriverType_DBGMB
    bool
    default y
    depends on MCUX_HW_DEVICE_ID_MCXC162

config MCUX_HW_IP_DriverType_EDMA3
    bool
    default y
    depends on MCUX_HW_DEVICE_ID_MCXC162

config MCUX_HW_IP_DriverType_EIM
    bool
    default y
    depends on MCUX_HW_DEVICE_ID_MCXC162

config MCUX_HW_IP_DriverType_ERM
    bool
    default y
    depends on MCUX_HW_DEVICE_ID_MCXC162

config MCUX_HW_IP_DriverType_FLASH_K4
    bool
    default y
    depends on MCUX_HW_DEVICE_ID_MCXC162

config MCUX_HW_IP_DriverType_FMC
    bool
    default y
    depends on MCUX_HW_DEVICE_ID_MCXC162

config MCUX_HW_IP_DriverType_FMU
    bool
    default y
    depends on MCUX_HW_DEVICE_ID_MCXC162

config MCUX_HW_IP_DriverType_FREQME
    bool
    default y
    depends on MCUX_HW_DEVICE_ID_MCXC162

config MCUX_HW_IP_DriverType_GPIO
    bool
    default y
    depends on MCUX_HW_DEVICE_ID_MCXC162

config MCUX_HW_IP_DriverType_INPUTMUX
    bool
    default y
    depends on MCUX_HW_DEVICE_ID_MCXC162

config MCUX_HW_IP_DriverType_LPADC
    bool
    default y
    depends on MCUX_HW_DEVICE_ID_MCXC162

config MCUX_HW_IP_DriverType_LPCMP
    bool
    default y
    depends on MCUX_HW_DEVICE_ID_MCXC162

config MCUX_HW_IP_DriverType_LPC_SYSCON
    bool
    default y
    depends on MCUX_HW_DEVICE_ID_MCXC162

config MCUX_HW_IP_DriverType_LPI2C
    bool
    default y
    depends on MCUX_HW_DEVICE_ID_MCXC162

config MCUX_HW_IP_DriverType_LPSPI
    bool
    default y
    depends on MCUX_HW_DEVICE_ID_MCXC162

config MCUX_HW_IP_DriverType_LPTMR
    bool
    default y
    depends on MCUX_HW_DEVICE_ID_MCXC162

config MCUX_HW_IP_DriverType_LPUART
    bool
    default y
    depends on MCUX_HW_DEVICE_ID_MCXC162

config MCUX_HW_IP_DriverType_MCX_CMC
    bool
    default y
    depends on MCUX_HW_DEVICE_ID_MCXC162

config MCUX_HW_IP_DriverType_MCX_SPC
    bool
    default y
    depends on MCUX_HW_DEVICE_ID_MCXC162

config MCUX_HW_IP_DriverType_MCX_VBAT
    bool
    default y
    depends on MCUX_HW_DEVICE_ID_MCXC162

config MCUX_HW_IP_DriverType_MRCC
    bool
    default y
    depends on MCUX_HW_DEVICE_ID_MCXC162

config MCUX_HW_IP_DriverType_OPAMP
    bool
    default y
    depends on MCUX_HW_DEVICE_ID_MCXC162

config MCUX_HW_IP_DriverType_PORT
    bool
    default y
    depends on MCUX_HW_DEVICE_ID_MCXC162

config MCUX_HW_IP_DriverType_PWM
    bool
    default y
    depends on MCUX_HW_DEVICE_ID_MCXC162

config MCUX_HW_IP_DriverType_SRTC
    bool
    default y
    depends on MCUX_HW_DEVICE_ID_MCXC162

config MCUX_HW_IP_DriverType_SCG
    bool
    default y
    depends on MCUX_HW_DEVICE_ID_MCXC162

config MCUX_HW_IP_DriverType_TRDC_1
    bool
    default y
    depends on MCUX_HW_DEVICE_ID_MCXC162

config MCUX_HW_IP_DriverType_WUU
    bool
    default y
    depends on MCUX_HW_DEVICE_ID_MCXC162

config MCUX_HW_IP_DriverType_WWDT
    bool
    default y
    depends on MCUX_HW_DEVICE_ID_MCXC162

config MCUX_HW_IP_DriverType_TRNG
    bool
    default y
    depends on MCUX_HW_DEVICE_ID_MCXC162
```

## MCXE/MCXE247/Kconfig.chip
```kconfig
# Copyright 2024 NXP
# All rights reserved.
#
# SPDX-License-Identifier: BSD-3-Clause
# core related
config MCUX_HW_CORE
    string
    default "cm4f"

config MCUX_HW_CORE_CM4F
    bool
    default y

config MCUX_HW_CORE_ID
    string
    default "cm4"

config MCUX_HW_CORE_ID_CM4
    bool
    default y

config MCUX_HW_DEVICE_CORE
    string
    default "MCXE247"

config MCUX_HW_FPU
    string
    default "SP_FPU"

config MCUX_HW_FPU_TYPE
    string
    default "fpv4_sp"

config MCUX_HW_FPV4_SP
    bool
    default y

config MCUX_HW_INT_PRIO_BITS
    int
    default 3

config MCUX_HW_DSP
    bool
    default y

config MCUX_HW_SAU
    bool
    default n

config MCUX_HW_SOC_SERIES_MCX
    bool
    default y

config MCUX_HW_SOC_SINGLECORE_DEVICE
    bool
    default y

# device related

config MCUX_HW_DEVICE_ID_MCXE247
    bool

choice
    prompt "Device MCXE247 Part"
    config MCUX_HW_DEVICE_PART_MCXE247VLQ
    bool "MCXE247VLQ"
    select MCUX_HW_DEVICE_ID_MCXE247
    config MCUX_HW_DEVICE_PART_MCXE247VLL
    bool "MCXE247VLL"
    select MCUX_HW_DEVICE_ID_MCXE247
endchoice

config MCUX_HW_DEVICE_ID
    string
    default "MCXE247" if MCUX_HW_DEVICE_ID_MCXE247

config MCUX_HW_DEVICE_PART
    string
    default "MCXE247VLQ" if MCUX_HW_DEVICE_PART_MCXE247VLQ
    default "MCXE247VLL" if MCUX_HW_DEVICE_PART_MCXE247VLL

# For chipmodel generated files
config MCUX_TOOLCHAIN_LINKER_DEVICE_PREFIX
    string
    default "MCXE247" if MCUX_HW_DEVICE_ID_MCXE247

config MCUX_TOOLCHAIN_MCUX_STARTUP
    string
    default "mcxe247"

# Toolchain related

config MCUX_TOOLCHAIN_IAR_CPU_IDENTIFIER
    string
    default "MCXE247" if MCUX_HW_DEVICE_ID_MCXE247

config MCUX_TOOLCHAIN_MDK_CPU_IDENTIFIER
    string
    default "MCXE247VLQ" if MCUX_HW_DEVICE_PART_MCXE247VLQ
    default "MCXE247VLL" if MCUX_HW_DEVICE_PART_MCXE247VLL

config MCUX_TOOLCHAIN_JLINK_CPU_IDENTIFIER
    string
    default "MCXE247" if MCUX_HW_DEVICE_ID_MCXE247

config MCUX_HW_IP_DriverType_ACMP
    bool
    default y
    depends on MCUX_HW_DEVICE_ID_MCXE247

config MCUX_HW_IP_DriverType_ADC12
    bool
    default y
    depends on MCUX_HW_DEVICE_ID_MCXE247

config MCUX_HW_IP_DriverType_AIPS
    bool
    default y
    depends on MCUX_HW_DEVICE_ID_MCXE247

config MCUX_HW_IP_DriverType_CRC
    bool
    default y
    depends on MCUX_HW_DEVICE_ID_MCXE247

config MCUX_HW_IP_DriverType_CSEC
    bool
    default y
    depends on MCUX_HW_DEVICE_ID_MCXE247

config MCUX_HW_IP_DriverType_DMAMUX
    bool
    default y
    depends on MCUX_HW_DEVICE_ID_MCXE247

config MCUX_HW_IP_DriverType_EDMA
    bool
    default y
    depends on MCUX_HW_DEVICE_ID_MCXE247

config MCUX_HW_IP_DriverType_ENET
    bool
    default y
    depends on MCUX_HW_DEVICE_ID_MCXE247

config MCUX_HW_IP_DriverType_EWM
    bool
    default y
    depends on MCUX_HW_DEVICE_ID_MCXE247

config MCUX_HW_IP_DriverType_FLEXCAN
    bool
    default y
    depends on MCUX_HW_DEVICE_ID_MCXE247

config MCUX_HW_IP_DriverType_FLEXIO
    bool
    default y
    depends on MCUX_HW_DEVICE_ID_MCXE247

config MCUX_HW_IP_DriverType_FTFC
    bool
    default y
    depends on MCUX_HW_DEVICE_ID_MCXE247

config MCUX_HW_IP_DriverType_FTM
    bool
    default y
    depends on MCUX_HW_DEVICE_ID_MCXE247

config MCUX_HW_IP_DriverType_GPIO
    bool
    default y
    depends on MCUX_HW_DEVICE_ID_MCXE247

config MCUX_HW_IP_DriverType_LMEM
    bool
    default y
    depends on MCUX_HW_DEVICE_ID_MCXE247

config MCUX_HW_IP_DriverType_LPI2C
    bool
    default y
    depends on MCUX_HW_DEVICE_ID_MCXE247

config MCUX_HW_IP_DriverType_LPIT
    bool
    default y
    depends on MCUX_HW_DEVICE_ID_MCXE247

config MCUX_HW_IP_DriverType_LPSPI
    bool
    default y
    depends on MCUX_HW_DEVICE_ID_MCXE247

config MCUX_HW_IP_DriverType_LPTMR
    bool
    default y
    depends on MCUX_HW_DEVICE_ID_MCXE247

config MCUX_HW_IP_DriverType_LPUART
    bool
    default y
    depends on MCUX_HW_DEVICE_ID_MCXE247

config MCUX_HW_IP_DriverType_PCC
    bool
    default y
    depends on MCUX_HW_DEVICE_ID_MCXE247

config MCUX_HW_IP_DriverType_PDB
    bool
    default y
    depends on MCUX_HW_DEVICE_ID_MCXE247

config MCUX_HW_IP_DriverType_PMC
    bool
    default y
    depends on MCUX_HW_DEVICE_ID_MCXE247

config MCUX_HW_IP_DriverType_PORT
    bool
    default y
    depends on MCUX_HW_DEVICE_ID_MCXE247

config MCUX_HW_IP_DriverType_QSPI
    bool
    default y
    depends on MCUX_HW_DEVICE_ID_MCXE247

config MCUX_HW_IP_DriverType_RCM
    bool
    default y
    depends on MCUX_HW_DEVICE_ID_MCXE247

config MCUX_HW_IP_DriverType_SRTC
    bool
    default y
    depends on MCUX_HW_DEVICE_ID_MCXE247

config MCUX_HW_IP_DriverType_SAI
    bool
    default y
    depends on MCUX_HW_DEVICE_ID_MCXE247

config MCUX_HW_IP_DriverType_SIM
    bool
    default y
    depends on MCUX_HW_DEVICE_ID_MCXE247

config MCUX_HW_IP_DriverType_SMC
    bool
    default y
    depends on MCUX_HW_DEVICE_ID_MCXE247

config MCUX_HW_IP_DriverType_SYSMPU
    bool
    default y
    depends on MCUX_HW_DEVICE_ID_MCXE247

config MCUX_HW_IP_DriverType_TRGMUX
    bool
    default y
    depends on MCUX_HW_DEVICE_ID_MCXE247

config MCUX_HW_IP_DriverType_WDOG32
    bool
    default y
    depends on MCUX_HW_DEVICE_ID_MCXE247
```

## MCXE/MCXE247/drivers/Kconfig
```kconfig
# Copyright 2025 NXP
# All rights reserved.
#
# SPDX-License-Identifier: BSD-3-Clause

menu "Device specific drivers configuration"

    config MCUX_COMPONENT_driver.clock
         bool "clock"
         default y

    config MCUX_COMPONENT_driver.flexcan_soc
         bool "flexcan_soc"
         default n

endmenu
```

## MCXE/MCXE317/Kconfig
```kconfig
# Copyright 2025 NXP
#
# SPDX-License-Identifier: BSD-3-Clause

rsource "Kconfig.chip"
rsource "drivers/Kconfig"
rsource "../../../../devices/arm/Kconfig.common"
rsource "Kconfig.defconfig"

## Project segment and component dependency data
config MCUX_HW_DEVICE_MCXE317
    # bool "Device MCXE317 Configuration"
    bool
    default y

    # component dependency
    select MCUX_COMPONENT_component.lpuart_adapter if MCUX_COMPONENT_component.serial_manager_uart
    select MCUX_COMPONENT_component.lpuart_adapter if MCUX_COMPONENT_utility.debug_console_lite
    select MCUX_COMPONENT_driver.lpspi_edma if MCUX_COMPONENT_driver.cmsis_lpspi
    select MCUX_COMPONENT_driver.lpi2c_edma if MCUX_COMPONENT_driver.cmsis_lpi2c
    select MCUX_COMPONENT_driver.lpuart_edma if MCUX_COMPONENT_driver.cmsis_lpuart
```
