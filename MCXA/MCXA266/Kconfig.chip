## MCXL/MCXL143/Kconfig.chip
```kconfig
# core related
config MCUX_HW_CORE
    string
    default "cm33"

config MCUX_HW_CORE_CM33
    bool
    default y

config MCUX_HW_CORE_ID
    string
    default "cm33"

config MCUX_HW_CORE_ID_CM33
    bool
    default y

config MCUX_HW_DEVICE_CORE
    string
    default "MCXL143"

config MCUX_HW_FPU
    string
    default "NO_FPU"

config MCUX_HW_FPU_TYPE
    string
    default "no_fpu"

config MCUX_HW_NO_FPU
    bool
    default y

config MCUX_HW_INT_PRIO_BITS
    int
    default 3

config MCUX_HW_DSP
    bool
    default n

config MCUX_HW_SAU
    bool
    default n

config MCUX_HW_SOC_SERIES_MCX
    bool
    default y

config MCUX_HW_SOC_SINGLECORE_DEVICE
    bool
    default y

# device related

config MCUX_HW_DEVICE_ID_MCXL143xxx
    bool

choice
    prompt "Device MCXL143 Part"
    config MCUX_HW_DEVICE_PART_MCXL143VLH
    bool "Device part MCXL143VLH"
    select MCUX_HW_DEVICE_ID_MCXL143xxx
    config MCUX_HW_DEVICE_PART_MCXL143VPJ
    bool "Device part MCXL143VPJ"
    select MCUX_HW_DEVICE_ID_MCXL143xxx
endchoice

config MCUX_HW_DEVICE_ID
    string
    default "MCXL143xxx" if MCUX_HW_DEVICE_ID_MCXL143xxx

config MCUX_HW_DEVICE_PART
    string
    default "MCXL143VLH" if MCUX_HW_DEVICE_PART_MCXL143VLH
    default "MCXL143VPJ" if MCUX_HW_DEVICE_PART_MCXL143VPJ

# For chipmodel generated files
config MCUX_TOOLCHAIN_LINKER_DEVICE_PREFIX
    string
    default "MCXL143" if MCUX_HW_DEVICE_ID_MCXL143xxx

config MCUX_TOOLCHAIN_MCUX_STARTUP
    string
    default "mcxl143"

# Toolchain related

config MCUX_TOOLCHAIN_IAR_CPU_IDENTIFIER
    string
    default "MCXL143xxx" if MCUX_HW_DEVICE_ID_MCXL143xxx

config MCUX_TOOLCHAIN_MDK_CPU_IDENTIFIER
    string
    default "MCXL143VLH" if MCUX_HW_DEVICE_PART_MCXL143VLH
    default "MCXL143VPJ" if MCUX_HW_DEVICE_PART_MCXL143VPJ

config MCUX_TOOLCHAIN_JLINK_CPU_IDENTIFIER
    string
    default "MCXL143xxx" if MCUX_HW_DEVICE_ID_MCXL143xxx

# ip information
config MCUX_HW_IP_DriverType_AOI
    bool
    default y
    depends on MCUX_HW_DEVICE_ID_MCXL143xxx

config MCUX_HW_IP_DriverType_ARM
    bool
    default y
    depends on MCUX_HW_DEVICE_ID_MCXL143xxx

config MCUX_HW_IP_DriverType_ATX
    bool
    default y
    depends on MCUX_HW_DEVICE_ID_MCXL143xxx

config MCUX_HW_IP_DriverType_CDOG
    bool
    default y
    depends on MCUX_HW_DEVICE_ID_MCXL143xxx

config MCUX_HW_IP_DriverType_CORE
    bool
    default y
    depends on MCUX_HW_DEVICE_ID_MCXL143xxx

config MCUX_HW_IP_DriverType_CRC
    bool
    default y
    depends on MCUX_HW_DEVICE_ID_MCXL143xxx

config MCUX_HW_IP_DriverType_CTIMER
    bool
    default y
    depends on MCUX_HW_DEVICE_ID_MCXL143xxx

config MCUX_HW_IP_DriverType_DBGMB
    bool
    default y
    depends on MCUX_HW_DEVICE_ID_MCXL143xxx

config MCUX_HW_IP_DriverType_EDMA3
    bool
    default y
    depends on MCUX_HW_DEVICE_ID_MCXL143xxx

config MCUX_HW_IP_DriverType_EQDC
    bool
    default y
    depends on MCUX_HW_DEVICE_ID_MCXL143xxx

config MCUX_HW_IP_DriverType_FMC
    bool
    default y
    depends on MCUX_HW_DEVICE_ID_MCXL143xxx

config MCUX_HW_IP_DriverType_FMU
    bool
    default y
    depends on MCUX_HW_DEVICE_ID_MCXL143xxx

config MCUX_HW_IP_DriverType_FREQME
    bool
    default y
    depends on MCUX_HW_DEVICE_ID_MCXL143xxx

config MCUX_HW_IP_DriverType_GLIKEY
    bool
    default y
    depends on MCUX_HW_DEVICE_ID_MCXL143xxx

config MCUX_HW_IP_DriverType_GPIO
    bool
    default y
    depends on MCUX_HW_DEVICE_ID_MCXL143xxx

config MCUX_HW_IP_DriverType_INPUTMUX
    bool
    default y
    depends on MCUX_HW_DEVICE_ID_MCXL143xxx

config MCUX_HW_IP_DriverType_JTAG
    bool
    default y
    depends on MCUX_HW_DEVICE_ID_MCXL143xxx

config MCUX_HW_IP_DriverType_LPADC
    bool
    default y
    depends on MCUX_HW_DEVICE_ID_MCXL143xxx

config MCUX_HW_IP_DriverType_LPCMP
    bool
    default y
    depends on MCUX_HW_DEVICE_ID_MCXL143xxx

config MCUX_HW_IP_DriverType_LPC_SYSCON
    bool
    default y
    depends on MCUX_HW_DEVICE_ID_MCXL143xxx

config MCUX_HW_IP_DriverType_LPI2C
    bool
    default y
    depends on MCUX_HW_DEVICE_ID_MCXL143xxx

config MCUX_HW_IP_DriverType_LPSPI
    bool
    default y
    depends on MCUX_HW_DEVICE_ID_MCXL143xxx

config MCUX_HW_IP_DriverType_LPTMR
    bool
    default y
    depends on MCUX_HW_DEVICE_ID_MCXL143xxx

config MCUX_HW_IP_DriverType_LPUART
    bool
    default y
    depends on MCUX_HW_DEVICE_ID_MCXL143xxx

config MCUX_HW_IP_DriverType_MCX_CMC
    bool
    default y
    depends on MCUX_HW_DEVICE_ID_MCXL143xxx

config MCUX_HW_IP_DriverType_MRCC
    bool
    default y
    depends on MCUX_HW_DEVICE_ID_MCXL143xxx

config MCUX_HW_IP_DriverType_MU_1
    bool
    default y
    depends on MCUX_HW_DEVICE_ID_MCXL143xxx

config MCUX_HW_IP_DriverType_OSTIMER
    bool
    default y
    depends on MCUX_HW_DEVICE_ID_MCXL143xxx

config MCUX_HW_IP_DriverType_PORT
    bool
    default y
    depends on MCUX_HW_DEVICE_ID_MCXL143xxx

config MCUX_HW_IP_DriverType_PWM
    bool
    default y
    depends on MCUX_HW_DEVICE_ID_MCXL143xxx

config MCUX_HW_IP_DriverType_SCG
    bool
    default y
    depends on MCUX_HW_DEVICE_ID_MCXL143xxx

config MCUX_HW_IP_DriverType_SMM
    bool
    default y
    depends on MCUX_HW_DEVICE_ID_MCXL143xxx

config MCUX_HW_IP_DriverType_SWD
    bool
    default y
    depends on MCUX_HW_DEVICE_ID_MCXL143xxx

config MCUX_HW_IP_DriverType_TRDC_1
    bool
    default y
    depends on MCUX_HW_DEVICE_ID_MCXL143xxx

config MCUX_HW_IP_DriverType_UTICK
    bool
    default y
    depends on MCUX_HW_DEVICE_ID_MCXL143xxx

config MCUX_HW_IP_DriverType_WUU
    bool
    default y
    depends on MCUX_HW_DEVICE_ID_MCXL143xxx

config MCUX_HW_IP_DriverType_WWDT
    bool
    default y
    depends on MCUX_HW_DEVICE_ID_MCXL143xxx
```

## MCXL/MCXL144/cm0plus/Kconfig
```kconfig
# Copyright 2026 NXP
#
# SPDX-License-Identifier: BSD-3-Clause

config MCUX_HW_DEVICE_MCXL144_CORE_ID_CM0P
    bool
    default y

rsource "Kconfig.chip"
rsource "Kconfig.defconfig"
```

## MCXL/MCXL144/drivers/Kconfig
```kconfig
# Copyright 2024 NXP
# All rights reserved.
#
# SPDX-License-Identifier: BSD-3-Clause

menu "Device specific drivers configuration"

    config MCUX_COMPONENT_driver.aon_common
         bool "Use driver aon_common"
         default y

    config MCUX_COMPONENT_driver.clock
         bool "Use driver clock"
         default y

    config MCUX_COMPONENT_driver.edma_soc
         bool "Use driver edma_soc"
         default n

    config MCUX_COMPONENT_driver.inputmux_connections
         bool "Use driver inputmux_connections"
         default y

    config MCUX_COMPONENT_driver.ipmq
         bool "Use driver ipmq"
         default y

    config MCUX_COMPONENT_driver.power
         bool "Use driver power"
         default y

    config MCUX_COMPONENT_driver.reset
         bool "Use driver reset"
         default y

    config MCUX_COMPONENT_driver.romapi
         bool "Use driver romapi"
         default y

    config MCUX_COMPONENT_driver.trdc_soc
         bool "Use driver trdc_soc"
         default n

    config MCUX_COMPONENT_driver.aon_rtc
         bool "Use driver aon_rtc"
         default n

    config MCUX_COMPONENT_driver.aon_gpio
         bool "Use driver aon_gpio"
         default n
endmenu
```

## MCXL/MCXL253/cm0plus/Kconfig
```kconfig
# Copyright 2024-2025 NXP
# All rights reserved.
#
# SPDX-License-Identifier: BSD-3-Clause

config MCUX_HW_DEVICE_MCXL253_CORE_ID_CM0P
    bool
    default y

#    imply MCUX_COMPONENT_driver.cache_armv7_m0 if MCUX_PRJSEG_module.device.suite

rsource "Kconfig.chip"
rsource "Kconfig.defconfig"
```

## MCXL/MCXL253/cm0plus/Kconfig.chip
```kconfig
# Copyright 2024-2025 NXP
# All rights reserved.
#
# SPDX-License-Identifier: BSD-3-Clause
# core related
config MCUX_HW_CORE
    string
    default "cm0p"

config MCUX_HW_CORE_CM0P
    bool
    default y

config MCUX_HW_CORE_ID
    string
    default "cm0plus"

config MCUX_HW_CORE_ID_CM0PLUS
    bool
    default y

config MCUX_HW_DEVICE_CORE
    string
    default "MCXL253_cm0plus"

config MCUX_HW_FPU
    string
    default "NO_FPU"

config MCUX_HW_FPU_TYPE
    string
    default "no_fpu"

config MCUX_HW_INT_PRIO_BITS
    int
    default 3

config MCUX_TOOLCHAIN_MCUX_STARTUP
    string
    default "mcxl253_cm0plus"

config MCUX_TOOLCHAIN_LINKER_DEVICE_PREFIX
    string
    default "MCXL253_cm0plus"

config MCUX_TOOLCHAIN_IAR_CPU_IDENTIFIER
    string
    default "MCXL253xxx_M0+"

config MCUX_TOOLCHAIN_MDK_CPU_IDENTIFIER
    string
    default "MCXL253VDF:cm0plus" if MCUX_HW_DEVICE_PART_MCXL253VDF
    default "MCXL253VLL:cm0plus" if MCUX_HW_DEVICE_PART_MCXL253VLL

config MCUX_TOOLCHAIN_JLINK_CPU_IDENTIFIER
    string
    default "MCXL253xxx_M0+"
```
