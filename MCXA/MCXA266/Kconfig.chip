## MCXA/MCXA537/Kconfig.chip
```kconfig
# Copyright 2025 NXP
#
# SPDX-License-Identifier: BSD-3-Clause

# core related
config MCUX_HW_CORE
    string
    default "cm33"

config MCUX_HW_CORE_CM33
    bool
    default y

config MCUX_HW_CORE_ID
    string
    default "cm33_core0"

config MCUX_HW_CORE_ID_CM33_CORE0
    bool
    default y

config MCUX_HW_DEVICE_CORE
    string
    default "MCXA537"

config MCUX_HW_FPU
    string
    default "SP_FPU"

config MCUX_HW_FPU_TYPE
    string
    default "fpv5_sp"

config MCUX_HW_FPV5_SP
    bool
    default y

config MCUX_HW_INT_PRIO_BITS
    int
    default 3

config MCUX_HW_DSP
    bool
    default y

config MCUX_HW_SAU
    bool
    default y

config MCUX_HW_SOC_SERIES_MCX
    bool
    default y

config MCUX_HW_SOC_SINGLECORE_DEVICE
    bool
    default y

# device related

config MCUX_HW_DEVICE_ID_MCXA537
    bool

choice
    prompt "Device MCXA537 Part"
    config MCUX_HW_DEVICE_PART_MCXA537VLQ
    bool "Device part MCXA537VLQ"
    select MCUX_HW_DEVICE_ID_MCXA537
    config MCUX_HW_DEVICE_PART_MCXA537VLL
    bool "Device part MCXA537VLL"
    select MCUX_HW_DEVICE_ID_MCXA537
    config MCUX_HW_DEVICE_PART_MCXA537VPN
    bool "Device part MCXA537VPN"
    select MCUX_HW_DEVICE_ID_MCXA537
endchoice

config MCUX_HW_DEVICE_ID
    string
    default "MCXA537" if MCUX_HW_DEVICE_ID_MCXA537

config MCUX_HW_DEVICE_PART
    string
    default "MCXA537VLQ" if MCUX_HW_DEVICE_PART_MCXA537VLQ
    default "MCXA537VLL" if MCUX_HW_DEVICE_PART_MCXA537VLL
    default "MCXA537VPN" if MCUX_HW_DEVICE_PART_MCXA537VPN

# For chipmodel generated files
config MCUX_TOOLCHAIN_LINKER_DEVICE_PREFIX
    string
    default "MCXA537" if MCUX_HW_DEVICE_ID_MCXA537

config MCUX_TOOLCHAIN_MCUX_STARTUP
    string
    default "mcxa537"

# Toolchain related

config MCUX_TOOLCHAIN_IAR_CPU_IDENTIFIER
    string
    default "MCXA537" if MCUX_HW_DEVICE_ID_MCXA537

config MCUX_TOOLCHAIN_MDK_CPU_IDENTIFIER
    string
    default "MCXA537VLQ" if MCUX_HW_DEVICE_PART_MCXA537VLQ
    default "MCXA537VLL" if MCUX_HW_DEVICE_PART_MCXA537VLL
    default "MCXA537VPN" if MCUX_HW_DEVICE_PART_MCXA537VPN

config MCUX_TOOLCHAIN_JLINK_CPU_IDENTIFIER
    string
    default "MCXA537" if MCUX_HW_DEVICE_ID_MCXA537

config MCUX_HW_IP_DriverType_FLEXIO_MCULCD
    bool
    default y
    depends on MCUX_HW_DEVICE_ID_MCXA537

# ip information
config MCUX_HW_IP_DriverType_AHBSC
    bool
    default y
    depends on MCUX_HW_DEVICE_ID_MCXA537

config MCUX_HW_IP_DriverType_AOI
    bool
    default y
    depends on MCUX_HW_DEVICE_ID_MCXA537

config MCUX_HW_IP_DriverType_CDOG
    bool
    default y
    depends on MCUX_HW_DEVICE_ID_MCXA537

config MCUX_HW_IP_DriverType_CRC
    bool
    default y
    depends on MCUX_HW_DEVICE_ID_MCXA537

config MCUX_HW_IP_DriverType_CTIMER
    bool
    default y
    depends on MCUX_HW_DEVICE_ID_MCXA537

config MCUX_HW_IP_DriverType_DBGMB
    bool
    default y
    depends on MCUX_HW_DEVICE_ID_MCXA537

config MCUX_HW_IP_DriverType_DIGTMP
    bool
    default y
    depends on MCUX_HW_DEVICE_ID_MCXA537

config MCUX_HW_IP_DriverType_EDMA3
    bool
    default y
    depends on MCUX_HW_DEVICE_ID_MCXA537

config MCUX_HW_IP_DriverType_EIM
    bool
    default y
    depends on MCUX_HW_DEVICE_ID_MCXA537

config MCUX_HW_IP_DriverType_ERM
    bool
    default y
    depends on MCUX_HW_DEVICE_ID_MCXA537

config MCUX_HW_IP_DriverType_ESPI
    bool
    default y
    depends on MCUX_HW_DEVICE_ID_MCXA537

config MCUX_HW_IP_DriverType_EWM
    bool
    default y
    depends on MCUX_HW_DEVICE_ID_MCXA537

config MCUX_HW_IP_DriverType_FLEXCAN
    bool
    default y
    depends on MCUX_HW_DEVICE_ID_MCXA537

config MCUX_HW_IP_DriverType_FLEXIO
    bool
    default y
    depends on MCUX_HW_DEVICE_ID_MCXA537

config MCUX_HW_IP_DriverType_FLEXSPI
    bool
    default y
    depends on MCUX_HW_DEVICE_ID_MCXA537

config MCUX_HW_IP_DriverType_FLEXSPI_IPED
    bool
    default y
    depends on MCUX_HW_DEVICE_ID_MCXA537

config MCUX_HW_IP_DriverType_FMC
    bool
    default y
    depends on MCUX_HW_DEVICE_ID_MCXA537

config MCUX_HW_IP_DriverType_FMU
    bool
    default y
    depends on MCUX_HW_DEVICE_ID_MCXA537

config MCUX_HW_IP_DriverType_FREQME
    bool
    default y
    depends on MCUX_HW_DEVICE_ID_MCXA537

config MCUX_HW_IP_DriverType_GDET
    bool
    default y
    depends on MCUX_HW_DEVICE_ID_MCXA537

config MCUX_HW_IP_DriverType_GLIKEY
    bool
    default y
    depends on MCUX_HW_DEVICE_ID_MCXA537

config MCUX_HW_IP_DriverType_GPIO
    bool
    default y
    depends on MCUX_HW_DEVICE_ID_MCXA537

config MCUX_HW_IP_DriverType_I1S
    bool
    default y
    depends on MCUX_HW_DEVICE_ID_MCXA537

config MCUX_HW_IP_DriverType_I3C
    bool
    default y
    depends on MCUX_HW_DEVICE_ID_MCXA537

config MCUX_HW_IP_DriverType_INPUTMUX
    bool
    default y
    depends on MCUX_HW_DEVICE_ID_MCXA537

config MCUX_HW_IP_DriverType_ITRC
    bool
    default y
    depends on MCUX_HW_DEVICE_ID_MCXA537

config MCUX_HW_IP_DriverType_LPADC
    bool
    default y
    depends on MCUX_HW_DEVICE_ID_MCXA537

config MCUX_HW_IP_DriverType_LPCMP
    bool
    default y
    depends on MCUX_HW_DEVICE_ID_MCXA537

config MCUX_HW_IP_DriverType_LPC_SYSCON
    bool
    default y
    depends on MCUX_HW_DEVICE_ID_MCXA537

config MCUX_HW_IP_DriverType_LPDAC
    bool
    default y
    depends on MCUX_HW_DEVICE_ID_MCXA537

config MCUX_HW_IP_DriverType_LPI2C
    bool
    default y
    depends on MCUX_HW_DEVICE_ID_MCXA537

config MCUX_HW_IP_DriverType_LPSPI
    bool
    default y
    depends on MCUX_HW_DEVICE_ID_MCXA537

config MCUX_HW_IP_DriverType_LPTMR
    bool
    default y
    depends on MCUX_HW_DEVICE_ID_MCXA537

config MCUX_HW_IP_DriverType_LPUART
    bool
    default y
    depends on MCUX_HW_DEVICE_ID_MCXA537

config MCUX_HW_IP_DriverType_MCX_CMC
    bool
    default y
    depends on MCUX_HW_DEVICE_ID_MCXA537

config MCUX_HW_IP_DriverType_MCX_ENET
    bool
    default y
    depends on MCUX_HW_DEVICE_ID_MCXA537

config MCUX_HW_IP_DriverType_MCX_SPC
    bool
    default y
    depends on MCUX_HW_DEVICE_ID_MCXA537

config MCUX_HW_IP_DriverType_MCX_VBAT
    bool
    default y
    depends on MCUX_HW_DEVICE_ID_MCXA537

config MCUX_HW_IP_DriverType_MRCC
    bool
    default y
    depends on MCUX_HW_DEVICE_ID_MCXA537

config MCUX_HW_IP_DriverType_OSTIMER
    bool
    default y
    depends on MCUX_HW_DEVICE_ID_MCXA537

config MCUX_HW_IP_DriverType_PORT
    bool
    default y
    depends on MCUX_HW_DEVICE_ID_MCXA537

config MCUX_HW_IP_DriverType_PKC
    bool
    default y
    depends on MCUX_HW_DEVICE_ID_MCXA537

config MCUX_HW_IP_DriverType_RTC_V2
    bool
    default y
    depends on MCUX_HW_DEVICE_ID_MCXA537

config MCUX_HW_IP_DriverType_SCG
    bool
    default y
    depends on MCUX_HW_DEVICE_ID_MCXA537

config MCUX_HW_IP_DriverType_SECCON
    bool
    default y
    depends on MCUX_HW_DEVICE_ID_MCXA537

config MCUX_HW_IP_DriverType_SMARTDMA
    bool
    default y
    depends on MCUX_HW_DEVICE_ID_MCXA537

config MCUX_HW_IP_DriverType_SMARTDMA_MCXA
    bool
    default y
    depends on MCUX_HW_DEVICE_ID_MCXA537

config MCUX_HW_IP_DriverType_SPIFILTER
    bool
    default y
    depends on MCUX_HW_DEVICE_ID_MCXA537

config MCUX_HW_IP_DriverType_SGI
    bool
    default y
    depends on MCUX_HW_DEVICE_ID_MCXA537

config MCUX_HW_IP_DriverType_SYSCON_LPCAC
    bool
    default y
    depends on MCUX_HW_DEVICE_ID_MCXA537

config MCUX_HW_IP_DriverType_TRDC_1
    bool
    default y
    depends on MCUX_HW_DEVICE_ID_MCXA537

config MCUX_HW_IP_DriverType_TRNG
    bool
    default y
    depends on MCUX_HW_DEVICE_ID_MCXA537

config MCUX_HW_IP_DriverType_TSI_V6
    bool
    default y
    depends on MCUX_HW_DEVICE_ID_MCXA537

config MCUX_HW_IP_DriverType_USBNC
    bool
    default y
    depends on MCUX_HW_DEVICE_ID_MCXA537

config MCUX_HW_IP_DriverType_USB_HOST_DEVICE_EHCI
    bool
    default y
    depends on MCUX_HW_DEVICE_ID_MCXA537


config MCUX_HW_IP_DriverType_USB_PHY
    bool
    default y
    depends on MCUX_HW_DEVICE_ID_MCXA537

config MCUX_HW_IP_DriverType_UTICK
    bool
    default y
    depends on MCUX_HW_DEVICE_ID_MCXA537

config MCUX_HW_IP_DriverType_VREF_1
    bool
    default y
    depends on MCUX_HW_DEVICE_ID_MCXA537

config MCUX_HW_IP_DriverType_WAKETIMER
    bool
    default y
    depends on MCUX_HW_DEVICE_ID_MCXA537

config MCUX_HW_IP_DriverType_WUU
    bool
    default y
    depends on MCUX_HW_DEVICE_ID_MCXA537

config MCUX_HW_IP_DriverType_WWDT
    bool
    default y
    depends on MCUX_HW_DEVICE_ID_MCXA537
```

## MCXC/MCXC161/Kconfig.chip
```kconfig
# Copyright 2025 NXP
#
# SPDX-License-Identifier: BSD-3-Clause

# core related
config MCUX_HW_CORE
    string
    default "cm23"

config MCUX_HW_CORE_CM23
    bool
    default y

config MCUX_HW_CORE_ID
    string
    default "cm23_core0"

config MCUX_HW_CORE_ID_CM23_CORE0
    bool
    default y

config MCUX_HW_DEVICE_CORE
    string
    default "MCXC161"

config MCUX_HW_FPU
    string
    default "NO_FPU"

config MCUX_HW_FPU_TYPE
    string
    default "no_fpu"

config MCUX_HW_NO_FPU
    bool
    default y

config MCUX_HW_INT_PRIO_BITS
    int
    default 2

config MCUX_HW_SAU
    bool
    default n

config MCUX_HW_SOC_SERIES_MCX
    bool
    default y

config MCUX_HW_SOC_SINGLECORE_DEVICE
    bool
    default y

# device related

config MCUX_HW_DEVICE_ID_MCXC161
    bool

choice MCUX_HW_DEVICE_PART_MCXC161
    prompt "Device MCXC161 Part"
    config MCUX_HW_DEVICE_PART_MCXC161VFG
    bool "MCXC161VFG"
    select MCUX_HW_DEVICE_ID_MCXC161
    config MCUX_HW_DEVICE_PART_MCXC161VFK
    bool "MCXC161VFK"
    select MCUX_HW_DEVICE_ID_MCXC161
    config MCUX_HW_DEVICE_PART_MCXC161VFM
    bool "MCXC161VFM"
    select MCUX_HW_DEVICE_ID_MCXC161
    config MCUX_HW_DEVICE_PART_MCXC161VFT
    bool "MCXC161VFT"
    select MCUX_HW_DEVICE_ID_MCXC161
    config MCUX_HW_DEVICE_PART_MCXC161VLF
    bool "MCXC161VLF"
    select MCUX_HW_DEVICE_ID_MCXC161
endchoice

config MCUX_HW_DEVICE_ID
    string
    default "MCXC161" if MCUX_HW_DEVICE_ID_MCXC161

config MCUX_HW_DEVICE_PART
    string
    default "MCXC161VFG" if MCUX_HW_DEVICE_PART_MCXC161VFG
    default "MCXC161VFK" if MCUX_HW_DEVICE_PART_MCXC161VFK
    default "MCXC161VFM" if MCUX_HW_DEVICE_PART_MCXC161VFM
    default "MCXC161VFT" if MCUX_HW_DEVICE_PART_MCXC161VFT
    default "MCXC161VLF" if MCUX_HW_DEVICE_PART_MCXC161VLF

# For chipmodel generated files
config MCUX_TOOLCHAIN_LINKER_DEVICE_PREFIX
    string
    default "MCXC161" if MCUX_HW_DEVICE_ID_MCXC161

config MCUX_TOOLCHAIN_MCUX_STARTUP
    string
    default "mcxc161"

# Toolchain related

config MCUX_TOOLCHAIN_IAR_CPU_IDENTIFIER
    string
    default "MCXC161" if MCUX_HW_DEVICE_ID_MCXC161

config MCUX_TOOLCHAIN_MDK_CPU_IDENTIFIER
    string
    default "MCXC161VFG" if MCUX_HW_DEVICE_PART_MCXC161VFG
    default "MCXC161VFK" if MCUX_HW_DEVICE_PART_MCXC161VFK
    default "MCXC161VFM" if MCUX_HW_DEVICE_PART_MCXC161VFM
    default "MCXC161VFT" if MCUX_HW_DEVICE_PART_MCXC161VFT
    default "MCXC161VLF" if MCUX_HW_DEVICE_PART_MCXC161VLF

config MCUX_TOOLCHAIN_JLINK_CPU_IDENTIFIER
    string
    default "MCXC161" if MCUX_HW_DEVICE_ID_MCXC161

# ip information
config MCUX_HW_IP_DriverType_CRC
    bool
    default y
    depends on MCUX_HW_DEVICE_ID_MCXC161

config MCUX_HW_IP_DriverType_CTIMER
    bool
    default y
    depends on MCUX_HW_DEVICE_ID_MCXC161

config MCUX_HW_IP_DriverType_DBGMB
    bool
    default y
    depends on MCUX_HW_DEVICE_ID_MCXC161

config MCUX_HW_IP_DriverType_EDMA3
    bool
    default y
    depends on MCUX_HW_DEVICE_ID_MCXC161

config MCUX_HW_IP_DriverType_EIM
    bool
    default y
    depends on MCUX_HW_DEVICE_ID_MCXC161

config MCUX_HW_IP_DriverType_EQDC
    bool
    default y
    depends on MCUX_HW_DEVICE_ID_MCXC161

config MCUX_HW_IP_DriverType_ERM
    bool
    default y
    depends on MCUX_HW_DEVICE_ID_MCXC161

config MCUX_HW_IP_DriverType_FLASH_K4
    bool
    default y
    depends on MCUX_HW_DEVICE_ID_MCXC161

config MCUX_HW_IP_DriverType_FMC
    bool
    default y
    depends on MCUX_HW_DEVICE_ID_MCXC161

config MCUX_HW_IP_DriverType_FMU
    bool
    default y
    depends on MCUX_HW_DEVICE_ID_MCXC161

config MCUX_HW_IP_DriverType_FREQME
    bool
    default y
    depends on MCUX_HW_DEVICE_ID_MCXC161

config MCUX_HW_IP_DriverType_GPIO
    bool
    default y
    depends on MCUX_HW_DEVICE_ID_MCXC161

config MCUX_HW_IP_DriverType_INPUTMUX
    bool
    default y
    depends on MCUX_HW_DEVICE_ID_MCXC161

config MCUX_HW_IP_DriverType_LPADC
    bool
    default y
    depends on MCUX_HW_DEVICE_ID_MCXC161

config MCUX_HW_IP_DriverType_LPCMP
    bool
    default y
    depends on MCUX_HW_DEVICE_ID_MCXC161

config MCUX_HW_IP_DriverType_LPC_SYSCON
    bool
    default y
    depends on MCUX_HW_DEVICE_ID_MCXC161

config MCUX_HW_IP_DriverType_LPI2C
    bool
    default y
    depends on MCUX_HW_DEVICE_ID_MCXC161

config MCUX_HW_IP_DriverType_LPSPI
    bool
    default y
    depends on MCUX_HW_DEVICE_ID_MCXC161

config MCUX_HW_IP_DriverType_LPTMR
    bool
    default y
    depends on MCUX_HW_DEVICE_ID_MCXC161

config MCUX_HW_IP_DriverType_LPUART
    bool
    default y
    depends on MCUX_HW_DEVICE_ID_MCXC161

config MCUX_HW_IP_DriverType_MCX_CMC
    bool
    default y
    depends on MCUX_HW_DEVICE_ID_MCXC161

config MCUX_HW_IP_DriverType_MCX_SPC
    bool
    default y
    depends on MCUX_HW_DEVICE_ID_MCXC161

config MCUX_HW_IP_DriverType_MCX_VBAT
    bool
    default y
    depends on MCUX_HW_DEVICE_ID_MCXC161

config MCUX_HW_IP_DriverType_MRCC
    bool
    default y
    depends on MCUX_HW_DEVICE_ID_MCXC161

config MCUX_HW_IP_DriverType_OPAMP
    bool
    default y
    depends on MCUX_HW_DEVICE_ID_MCXC161

config MCUX_HW_IP_DriverType_PORT
    bool
    default y
    depends on MCUX_HW_DEVICE_ID_MCXC161

config MCUX_HW_IP_DriverType_PWM
    bool
    default y
    depends on MCUX_HW_DEVICE_ID_MCXC161

config MCUX_HW_IP_DriverType_SRTC
    bool
    default y
    depends on MCUX_HW_DEVICE_ID_MCXC161

config MCUX_HW_IP_DriverType_SCG
    bool
    default y
    depends on MCUX_HW_DEVICE_ID_MCXC161

config MCUX_HW_IP_DriverType_TRDC_1
    bool
    default y
    depends on MCUX_HW_DEVICE_ID_MCXC161

config MCUX_HW_IP_DriverType_WUU
    bool
    default y
    depends on MCUX_HW_DEVICE_ID_MCXC161

config MCUX_HW_IP_DriverType_WWDT
    bool
    default y
    depends on MCUX_HW_DEVICE_ID_MCXC161

config MCUX_HW_IP_DriverType_TRNG
    bool
    default y
    depends on MCUX_HW_DEVICE_ID_MCXC161
```
