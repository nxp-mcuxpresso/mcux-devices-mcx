## MCXE/MCXE317/Kconfig.chip
```kconfig
# Copyright 2024-2025 NXP
#
# SPDX-License-Identifier: BSD-3-Clause

# device related

config MCUX_HW_DEVICE_ID_MCXE317
    bool

choice
    prompt "Device MCXE317 Part"
    config MCUX_HW_DEVICE_PART_MCXE317MPB
    bool "Device part MCXE317MPB"
    select MCUX_HW_DEVICE_ID_MCXE317
   config MCUX_HW_DEVICE_PART_MCXE317MPAA
    bool "Device part MCXE317MPA"
    select MCUX_HW_DEVICE_ID_MCXE317
endchoice

config MCUX_HW_DEVICE_ID
    string
    default "MCXE317" if MCUX_HW_DEVICE_ID_MCXE317

config MCUX_HW_DEVICE_PART
    string
    default "MCXE317MPB" if MCUX_HW_DEVICE_PART_MCXE317MPB
    default "MCXE317MPA" if MCUX_HW_DEVICE_PART_MCXE317MPA
# core related
config MCUX_HW_CORE
    string
    default "cm7f"

config MCUX_HW_CORE_CM7F
    bool
    default y

config MCUX_HW_CORE_ID
    string
    default "cm7"

config MCUX_HW_DEVICE_CORE
    string
    default "MCXE317"

config MCUX_HW_FPU
    string
    default "SP_FPU"

config MCUX_HW_FPU_TYPE
    string
    default "fpv5_sp"

config MCUX_HW_FPV5_SP
    bool
    default y

config MCUX_HW_INT_PRIO_BITS
    int
    default 4

config MCUX_HW_SOC_SERIES_MCX
    bool
    default y

config MCUX_HW_SOC_SINGLECORE_DEVICE
    bool
    default y

# For chipmodel generated files
config MCUX_TOOLCHAIN_LINKER_DEVICE_PREFIX
    string
    default "MCXE317" if MCUX_HW_DEVICE_ID_MCXE317

config MCUX_TOOLCHAIN_MCUX_STARTUP
    string
    default "MCXE317"

# Toolchain related

config MCUX_TOOLCHAIN_IAR_CPU_IDENTIFIER
    string
    default "MCXE317" if MCUX_HW_DEVICE_ID_MCXE317

config MCUX_TOOLCHAIN_MDK_CPU_IDENTIFIER
    string
    default "MCXE317MPB" if MCUX_HW_DEVICE_PART_MCXE317MPB

config MCUX_TOOLCHAIN_JLINK_CPU_IDENTIFIER
    string
    default "MCXE317" if MCUX_HW_DEVICE_ID_MCXE317

# ip information

config MCUX_HW_IP_DriverType_AIPS
    bool
    default y
    depends on MCUX_HW_DEVICE_ID_MCXE317

config MCUX_HW_IP_DriverType_CMU_FC
    bool
    default y
    depends on MCUX_HW_DEVICE_ID_MCXE317

config MCUX_HW_IP_DriverType_CMU_FM
    bool
    default y
    depends on MCUX_HW_DEVICE_ID_MCXE317

config MCUX_HW_IP_DriverType_CRC
    bool
    default y
    depends on MCUX_HW_DEVICE_ID_MCXE317

config MCUX_HW_IP_DriverType_DMAMUX
    bool
    default y
    depends on MCUX_HW_DEVICE_ID_MCXE317

config MCUX_HW_IP_DriverType_EDMA4
    bool
    default y
    depends on MCUX_HW_DEVICE_ID_MCXE317

#config MCUX_HW_IP_DriverType_EIM
#    bool
#    default y
#    depends on MCUX_HW_DEVICE_ID_MCXE317

config MCUX_HW_IP_DriverType_EMIOS
    bool
    default y
    depends on MCUX_HW_DEVICE_ID_MCXE317

#config MCUX_HW_IP_DriverType_ERM
#    bool
#    default y
#    depends on MCUX_HW_DEVICE_ID_MCXE317

config MCUX_HW_IP_DriverType_FLEXCAN
    bool
    default y
    depends on MCUX_HW_DEVICE_ID_MCXE317

config MCUX_HW_IP_DriverType_FLEXIO
    bool
    default y
    depends on MCUX_HW_DEVICE_ID_MCXE317

config MCUX_HW_IP_DriverType_INTM
    bool
    default y
    depends on MCUX_HW_DEVICE_ID_MCXE317

config MCUX_HW_IP_DriverType_JDC
    bool
    default y
    depends on MCUX_HW_DEVICE_ID_MCXE317

config MCUX_HW_IP_DriverType_JTAGC
    bool
    default y
    depends on MCUX_HW_DEVICE_ID_MCXE317

config MCUX_HW_IP_DriverType_LCU
    bool
    default y
    depends on MCUX_HW_DEVICE_ID_MCXE317

config MCUX_HW_IP_DriverType_LPCMP
    bool
    default y
    depends on MCUX_HW_DEVICE_ID_MCXE317

config MCUX_HW_IP_DriverType_LPI2C
    bool
    default y
    depends on MCUX_HW_DEVICE_ID_MCXE317

config MCUX_HW_IP_DriverType_LPSPI
    bool
    default y
    depends on MCUX_HW_DEVICE_ID_MCXE317

config MCUX_HW_IP_DriverType_LPUART
    bool
    default y
    depends on MCUX_HW_DEVICE_ID_MCXE317

config MCUX_HW_IP_DriverType_MCM
    bool
    default y
    depends on MCUX_HW_DEVICE_ID_MCXE317

config MCUX_HW_IP_DriverType_MDM_AP
    bool
    default y
    depends on MCUX_HW_DEVICE_ID_MCXE317

config MCUX_HW_IP_DriverType_MSCM
    bool
    default y
    depends on MCUX_HW_DEVICE_ID_MCXE317

config MCUX_HW_IP_DriverType_SIUL2
    bool
    default y
    depends on MCUX_HW_DEVICE_ID_MCXE317

config MCUX_HW_IP_DriverType_PIT
    bool
    default y
    depends on MCUX_HW_DEVICE_ID_MCXE317

config MCUX_HW_IP_DriverType_PLLDIG
    bool
    default y
    depends on MCUX_HW_DEVICE_ID_MCXE317

config MCUX_HW_IP_DriverType_RTC_JDP
    bool
    default y
    depends on MCUX_HW_DEVICE_ID_MCXE317

config MCUX_HW_IP_DriverType_PMC2
    bool
    default y
    depends on MCUX_HW_DEVICE_ID_MCXE317

config MCUX_HW_IP_DriverType_SAR_ADC
    bool
    default y
    depends on MCUX_HW_DEVICE_ID_MCXE317

config MCUX_HW_IP_DriverType_STM
    bool
    default y
    depends on MCUX_HW_DEVICE_ID_MCXE317

config MCUX_HW_IP_DriverType_SWT
    bool
    default y
    depends on MCUX_HW_DEVICE_ID_MCXE317

config MCUX_HW_IP_DriverType_TRGMUX
    bool
    default y
    depends on MCUX_HW_DEVICE_ID_MCXE317

config MCUX_HW_IP_DriverType_WKPU
    bool
    default y
    depends on MCUX_HW_DEVICE_ID_MCXE317

config MCUX_HW_IP_DriverType_XBIC
    bool
    default y
    depends on MCUX_HW_DEVICE_ID_MCXE317

config MCUX_HW_IP_DriverType_XRDC
    bool
    default y
    depends on MCUX_HW_DEVICE_ID_MCXE317

config MCUX_HW_IP_DriverType_BCTU
    bool
    default y
    depends on MCUX_HW_DEVICE_ID_MCXE317

config MCUX_HW_IP_DriverType_TEMPSENSE
    bool
    default y
    depends on MCUX_HW_DEVICE_ID_MCXE317

config MCUX_HW_IP_DriverType_FLEXIO_MCULCD
    bool
    default y
    depends on MCUX_HW_DEVICE_ID_MCXE317

config MCUX_HW_IP_DriverType_PMC2
    bool
    default y
    depends on MCUX_HW_DEVICE_ID_MCXE317  

config MCUX_HW_IP_DriverType_MC_RGM
    bool
    default y
    depends on MCUX_HW_DEVICE_ID_MCXE317

config MCUX_HW_IP_DriverType_DCM_GPR
    bool
    default y
    depends on MCUX_HW_DEVICE_ID_MCXE317

config MCUX_HW_IP_DriverType_FLASH_C40
    bool
    default y
    depends on MCUX_HW_DEVICE_ID_MCXE317
```

## MCXE/MCXE317/drivers/Kconfig
```kconfig
# Copyright 2025 NXP
#
# SPDX-License-Identifier: BSD-3-Clause

menu "Device specific drivers configuration"
    rsource "../../MCXE31B/drivers/Kconfig_clock"
    rsource "../../MCXE31B/drivers/Kconfig_dcm_gpr"
    rsource "../../MCXE31B/drivers/Kconfig_edma_soc"
    rsource "../../MCXE31B/drivers/Kconfig_memory"
    rsource "../../MCXE31B/drivers/Kconfig_siul2"
    rsource "../../MCXE31B/drivers/Kconfig_power"
endmenu
```

## MCXE/MCXE317/xip/Kconfig
```kconfig
# Copyright 2026 NXP
#
#
# SPDX-License-Identifier: BSD-3-Clause

rsource "../../../MCXE/MCXE31B/xip/Kconfig"
```

## MCXE/MCXE31B/Kconfig.chip
```kconfig
# Copyright 2024-2025 NXP
#
# SPDX-License-Identifier: BSD-3-Clause

# device related

config MCUX_HW_DEVICE_ID_MCXE31B
    bool

choice
    prompt "Device MCXE31B Part"
    config MCUX_HW_DEVICE_PART_MCXE31BMPB
    bool "Device part MCXE31BMPB"
    select MCUX_HW_DEVICE_ID_MCXE31B
endchoice

config MCUX_HW_DEVICE_ID
    string
    default "MCXE31B" if MCUX_HW_DEVICE_ID_MCXE31B

config MCUX_HW_DEVICE_PART
    string
    default "MCXE31BMPB" if MCUX_HW_DEVICE_PART_MCXE31BMPB
# core related
config MCUX_HW_CORE
    string
    default "cm7f"

config MCUX_HW_CORE_CM7F
    bool
    default y

config MCUX_HW_CORE_ID
    string
    default "cm7"

config MCUX_HW_DEVICE_CORE
    string
    default "MCXE31B"

config MCUX_HW_FPU
    string
    default "SP_FPU"

config MCUX_HW_FPU_TYPE
    string
    default "fpv5_sp"

config MCUX_HW_FPV5_SP
    bool
    default y

config MCUX_HW_INT_PRIO_BITS
    int
    default 4

config MCUX_HW_SOC_SERIES_MCX
    bool
    default y

config MCUX_HW_SOC_SINGLECORE_DEVICE
    bool
    default y

# For chipmodel generated files
config MCUX_TOOLCHAIN_LINKER_DEVICE_PREFIX
    string
    default "MCXE31B" if MCUX_HW_DEVICE_ID_MCXE31B

config MCUX_TOOLCHAIN_MCUX_STARTUP
    string
    default "MCXE31B"

# Toolchain related

config MCUX_TOOLCHAIN_IAR_CPU_IDENTIFIER
    string
    default "MCXE31B" if MCUX_HW_DEVICE_ID_MCXE31B

config MCUX_TOOLCHAIN_MDK_CPU_IDENTIFIER
    string
    default "MCXE31BMPB" if MCUX_HW_DEVICE_PART_MCXE31BMPB

config MCUX_TOOLCHAIN_JLINK_CPU_IDENTIFIER
    string
    default "MCXE31B" if MCUX_HW_DEVICE_ID_MCXE31B

# ip information

config MCUX_HW_IP_DriverType_AIPS
    bool
    default y
    depends on MCUX_HW_DEVICE_ID_MCXE31B

config MCUX_HW_IP_DriverType_AXBS
    bool
    default y
    depends on MCUX_HW_DEVICE_ID_MCXE31B

config MCUX_HW_IP_DriverType_CMU_FC
    bool
    default y
    depends on MCUX_HW_DEVICE_ID_MCXE31B

config MCUX_HW_IP_DriverType_CMU_FM
    bool
    default y
    depends on MCUX_HW_DEVICE_ID_MCXE31B

config MCUX_HW_IP_DriverType_CRC
    bool
    default y
    depends on MCUX_HW_DEVICE_ID_MCXE31B

config MCUX_HW_IP_DriverType_DMAMUX
    bool
    default y
    depends on MCUX_HW_DEVICE_ID_MCXE31B

config MCUX_HW_IP_DriverType_EDMA4
    bool
    default y
    depends on MCUX_HW_DEVICE_ID_MCXE31B

#config MCUX_HW_IP_DriverType_EIM
#    bool
#    default y
#    depends on MCUX_HW_DEVICE_ID_MCXE31B

config MCUX_HW_IP_DriverType_EMIOS
    bool
    default y
    depends on MCUX_HW_DEVICE_ID_MCXE31B

#config MCUX_HW_IP_DriverType_ERM
#    bool
#    default y
#    depends on MCUX_HW_DEVICE_ID_MCXE31B

config MCUX_HW_IP_DriverType_FLEXCAN
    bool
    default y
    depends on MCUX_HW_DEVICE_ID_MCXE31B

config MCUX_HW_IP_DriverType_FLEXIO
    bool
    default y
    depends on MCUX_HW_DEVICE_ID_MCXE31B

config MCUX_HW_IP_DriverType_INTM
    bool
    default y
    depends on MCUX_HW_DEVICE_ID_MCXE31B

config MCUX_HW_IP_DriverType_JDC
    bool
    default y
    depends on MCUX_HW_DEVICE_ID_MCXE31B

config MCUX_HW_IP_DriverType_JTAGC
    bool
    default y
    depends on MCUX_HW_DEVICE_ID_MCXE31B

config MCUX_HW_IP_DriverType_LCU
    bool
    default y
    depends on MCUX_HW_DEVICE_ID_MCXE31B

config MCUX_HW_IP_DriverType_LPCMP
    bool
    default y
    depends on MCUX_HW_DEVICE_ID_MCXE31B

config MCUX_HW_IP_DriverType_LPI2C
    bool
    default y
    depends on MCUX_HW_DEVICE_ID_MCXE31B

config MCUX_HW_IP_DriverType_LPSPI
    bool
    default y
    depends on MCUX_HW_DEVICE_ID_MCXE31B

config MCUX_HW_IP_DriverType_QUADSPI
    bool
    default y
    depends on MCUX_HW_DEVICE_ID_MCXE31B

config MCUX_HW_IP_DriverType_LPUART
    bool
    default y
    depends on MCUX_HW_DEVICE_ID_MCXE31B

config MCUX_HW_IP_DriverType_MCM
    bool
    default y
    depends on MCUX_HW_DEVICE_ID_MCXE31B

config MCUX_HW_IP_DriverType_MDM_AP
    bool
    default y
    depends on MCUX_HW_DEVICE_ID_MCXE31B

config MCUX_HW_IP_DriverType_MSCM
    bool
    default y
    depends on MCUX_HW_DEVICE_ID_MCXE31B

config MCUX_HW_IP_DriverType_SIUL2
    bool
    default y
    depends on MCUX_HW_DEVICE_ID_MCXE31B

config MCUX_HW_IP_DriverType_PIT
    bool
    default y
    depends on MCUX_HW_DEVICE_ID_MCXE31B

config MCUX_HW_IP_DriverType_PLLDIG
    bool
    default y
    depends on MCUX_HW_DEVICE_ID_MCXE31B

config MCUX_HW_IP_DriverType_RTC_JDP
    bool
    default y
    depends on MCUX_HW_DEVICE_ID_MCXE31B

config MCUX_HW_IP_DriverType_PMC2
    bool
    default y
    depends on MCUX_HW_DEVICE_ID_MCXE31B

config MCUX_HW_IP_DriverType_SAI
    bool
    default y
    depends on MCUX_HW_DEVICE_ID_MCXE31B

config MCUX_HW_IP_DriverType_SAR_ADC
    bool
    default y
    depends on MCUX_HW_DEVICE_ID_MCXE31B

config MCUX_HW_IP_DriverType_SELFTEST_GPR
    bool
    default y
    depends on MCUX_HW_DEVICE_ID_MCXE31B

config MCUX_HW_IP_DriverType_SEMA42
    bool
    default y
    depends on MCUX_HW_DEVICE_ID_MCXE31B

config MCUX_HW_IP_DriverType_STM
    bool
    default y
    depends on MCUX_HW_DEVICE_ID_MCXE31B

config MCUX_HW_IP_DriverType_SWT
    bool
    default y
    depends on MCUX_HW_DEVICE_ID_MCXE31B

config MCUX_HW_IP_DriverType_TRGMUX
    bool
    default y
    depends on MCUX_HW_DEVICE_ID_MCXE31B

config MCUX_HW_IP_DriverType_WKPU
    bool
    default y
    depends on MCUX_HW_DEVICE_ID_MCXE31B

config MCUX_HW_IP_DriverType_XBIC
    bool
    default y
    depends on MCUX_HW_DEVICE_ID_MCXE31B

config MCUX_HW_IP_DriverType_XRDC
    bool
    default y
    depends on MCUX_HW_DEVICE_ID_MCXE31B

config MCUX_HW_IP_DriverType_BCTU
    bool
    default y
    depends on MCUX_HW_DEVICE_ID_MCXE31B

config MCUX_HW_IP_DriverType_TEMPSENSE
    bool
    default y
    depends on MCUX_HW_DEVICE_ID_MCXE31B

config MCUX_HW_IP_DriverType_FLEXIO_MCULCD
    bool
    default y
    depends on MCUX_HW_DEVICE_ID_MCXE31B

config MCUX_HW_IP_DriverType_PMC2
    bool
    default y
    depends on MCUX_HW_DEVICE_ID_MCXE31B  

config MCUX_HW_IP_DriverType_MC_RGM
    bool
    default y
    depends on MCUX_HW_DEVICE_ID_MCXE31B

config MCUX_HW_IP_DriverType_DCM_GPR
    bool
    default y
    depends on MCUX_HW_DEVICE_ID_MCXE31B

config MCUX_HW_IP_DriverType_FLASH_C40
    bool
    default y
    depends on MCUX_HW_DEVICE_ID_MCXE31B

config MCUX_HW_IP_DriverType_TSPC
    bool
    default y
    depends on MCUX_HW_DEVICE_ID_MCXE31B

config MCUX_HW_IP_DriverType_VIRT_WRAPPER
    bool
    default y
    depends on MCUX_HW_DEVICE_ID_MCXE31B
```

## MCXE/MCXE31B/drivers/Kconfig
```kconfig
# Copyright 2024 NXP
#
# SPDX-License-Identifier: BSD-3-Clause

menu "Device specific drivers configuration"
    rsource "./Kconfig_clock"
    rsource "./Kconfig_dcm_gpr"
    rsource "./Kconfig_dcm"
    rsource "./Kconfig_edma_soc"
    rsource "./Kconfig_memory"
    rsource "./Kconfig_siul2"
    rsource "./Kconfig_power"
endmenu
```

## MCXE/MCXE31B/xip/Kconfig
```kconfig
# Copyright 2026 NXP
#
#
# SPDX-License-Identifier: BSD-3-Clause

menu "Device Boot Header"
    config MCUX_COMPONENT_device.boot_header
        bool "Use device boot header"
endmenu
```

## MCXE/MCXE327/core0/Kconfig
```kconfig
# Copyright 2026 NXP
#
# SPDX-License-Identifier: BSD-3-Clause

config MCUX_HW_DEVICE_MCXE327_CORE_ID_core0
    bool
    default y

rsource "Kconfig.chip"
```

## MCXE/MCXE327/core1/Kconfig.chip
```kconfig
# Copyright 2024-2026 NXP
#
# SPDX-License-Identifier: BSD-3-Clause

# core related

config MCUX_HW_CORE
    string
    default "cm7f"

config MCUX_HW_CORE_CM7F
    bool
    default y

config MCUX_HW_CORE_ID
    string
    default "core1"

config MCUX_HW_CORE_ID_CORE1
    bool
    default y

config MCUX_HW_DSP
    bool
    default n

config MCUX_HW_MPU
    bool
    default y

config MCUX_HW_FPU
    string
    default "SP_FPU"

config MCUX_HW_FPU_TYPE
    string
    default "fpv5_sp"

config MCUX_HW_FPV5_SP
    bool
    default y

config MCUX_HW_SAU
    bool
    default n

config MCUX_HW_INT_PRIO_BITS
    int
    default 4

# device related

config MCUX_HW_DEVICE_CORE
    string
    default "MCXE327_cm7_core1"

# For chipmodel generated files

config MCUX_TOOLCHAIN_LINKER_DEVICE_PREFIX
    string
    default "MCXE327_cm7_core1" if MCUX_HW_DEVICE_ID_MCXE327

config MCUX_TOOLCHAIN_MCUX_STARTUP
    string
    default "mcxe327_cm7_core1"

# Toolchain related

config MCUX_TOOLCHAIN_IAR_CPU_IDENTIFIER
    string
    default "MCXE327_core1" if MCUX_HW_DEVICE_ID_MCXE327

config MCUX_TOOLCHAIN_MDK_CPU_IDENTIFIER
    string
    default "MCXE327MPA_core1" if MCUX_HW_DEVICE_PART_MCXE327MPA
    default "MCXE327MPB_core1" if MCUX_HW_DEVICE_PART_MCXE327MPB

config MCUX_TOOLCHAIN_JLINK_CPU_IDENTIFIER
    string
    default "MCXE327_core1" if MCUX_HW_DEVICE_ID_MCXE327
```
