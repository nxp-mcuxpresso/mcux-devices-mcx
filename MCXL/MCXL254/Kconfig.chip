## MCXL/MCXL255/cm33/Kconfig.chip
```kconfig
# Copyright 2024 NXP
# All rights reserved.
#
# SPDX-License-Identifier: BSD-3-Clause
# core related
config MCUX_HW_CORE
    string
    default "cm33"

config MCUX_HW_CORE_CM33
    bool
    default y

config MCUX_HW_CORE_ID
    string
    default "cm33"

config MCUX_HW_CORE_ID_CM33
    bool
    default y

config MCUX_HW_DEVICE_CORE
    string
    default "MCXL255_cm33"

config MCUX_HW_FPU
    string
    default "SP_FPU"

config MCUX_HW_FPU_TYPE
    string
    default "fpv5_sp"

config MCUX_HW_FPV5_SP
    bool
    default y

config MCUX_HW_INT_PRIO_BITS
    int
    default 3

config MCUX_HW_DSP
    bool
    default y

config MCUX_HW_SAU
    bool
    default y

config MCUX_TOOLCHAIN_MCUX_STARTUP
    string
    default "mcxl255_cm33"

config MCUX_TOOLCHAIN_LINKER_DEVICE_PREFIX
    string
    default "MCXL255_cm33"

config MCUX_TOOLCHAIN_IAR_CPU_IDENTIFIER
    string
    default "MCXL255xxx_M33"

config MCUX_TOOLCHAIN_MDK_CPU_IDENTIFIER
    string
    default "MCXL255VDF:cm33" if MCUX_HW_DEVICE_PART_MCXL255VDF
    default "MCXL255VLL:cm33" if MCUX_HW_DEVICE_PART_MCXL255VLL

config MCUX_TOOLCHAIN_JLINK_CPU_IDENTIFIER
    string
    default "MCXL255xxx_M33"
```

## MCXL/MCXL255/drivers/Kconfig
```kconfig
# Copyright 2024-2025 NXP
#
# SPDX-License-Identifier: BSD-3-Clause

menu "Device specific drivers configuration"

    rsource "romapi/Kconfig"

    config MCUX_COMPONENT_driver.clock
        bool "clock"
        default y

    if MCUX_COMPONENT_driver.clock

        config CLOCK_XTAL_DRIVE_PARAMS_COUNT
            int "XTAL drive parameters count"
            default 1
            help
                Count of XTAL drive parameters triplets
                used for Rosc initialization.

    endif

    config MCUX_COMPONENT_driver.edma_soc
         bool "edma_soc"
         default n

    config MCUX_COMPONENT_driver.inputmux_connections
         bool "inputmux_connections"
         default y

    config MCUX_COMPONENT_driver.advc
         bool "advc"
         select ADVC_DRIVER_USED
         default n

     config ADVC_DRIVER_USED # Workaround to overcome MCUX SDK package limitation
         bool "advc_driver"
         default n

    config MCUX_COMPONENT_driver.power
         bool "Use driver power"
         select MCUX_COMPONENT_driver.wuu if MCUX_HW_CORE_ID_CM33
         select MCUX_COMPONENT_driver.mcx_cmc if MCUX_HW_CORE_ID_CM33
         select MCUX_COMPONENT_driver.common if MCUX_HW_CORE_ID_CM0PLUS
         select MCUX_COMPONENT_driver.mu1
         select MCUX_COMPONENT_driver.smm
         select MCUX_COMPONENT_driver.pls_pmu
         select MCUX_COMPONENT_driver.advc

     if MCUX_COMPONENT_driver.power
          config POWER_MU_TRANSFER_TIMEOUT
               int "Maximum number of loops to wait for a response from the other core. A value of 0 indicates an infinite wait"
               default 0
               help
               The g_powerMuTransferState is updated when the secondary core parses the request message and sends a response.

          config POWER_CONTEXT_SAVING_DPD2_TO_DPD1_SYNC_TIMEOUT
               int "Specifies the maximum number of iterations to wait for dual-core synchronization after waking up from DPD2 to DPD1 with context saving enabled. Set to 0 to wait indefinitely"
               default 0
               help
               After waking up from DPD2 to DPD1 with context saving enabled, the CM0+ core waits to synchronize with the primary core.
     endif

    config MCUX_COMPONENT_driver.reset
         bool "reset"
         default y

    config MCUX_COMPONENT_driver.trdc_soc
         bool "trdc_soc"
         default n

endmenu
```

## MCXL/MCXL255/drivers/romapi/Kconfig
```kconfig
# Copyright 2025 NXP
#
# SPDX-License-Identifier: BSD-3-Clause

config MCUX_HAS_COMPONENT_driver.romapi
    bool
    default y

config MCUX_COMPONENT_driver.romapi
    bool "romapi"
    select MCUX_COMPONENT_driver.common
    depends on MCUX_HAS_COMPONENT_driver.romapi
```

## MCXN/MCXN246T/Kconfig.chip
```kconfig
# Copyright 2026 NXP
#
# SPDX-License-Identifier: BSD-3-Clause

# core related
config MCUX_HW_CORE
    string
    default "cm33"

config MCUX_HW_CORE_CM33
    bool
    default y

config MCUX_HW_CORE_ID
    string
    default "cm33_core0"

config MCUX_HW_CORE_ID_CM33_CORE0
    bool
    default y

config MCUX_HW_DEVICE_CORE
    string
    default "MCXN246T"

config MCUX_HW_FPU
    string
    default "SP_FPU"

config MCUX_HW_FPU_TYPE
    string
    default "fpv5_sp"

config MCUX_HW_FPV5_SP
    bool
    default y

config MCUX_HW_INT_PRIO_BITS
    int
    default 3

config MCUX_HW_DSP
    bool
    default y

config MCUX_HW_SAU
    bool
    default y

config MCUX_HW_SOC_SERIES_MCX
    bool
    default y

config MCUX_HW_SOC_SINGLECORE_DEVICE
    bool
    default y

# device related

config MCUX_HW_DEVICE_ID_MCXN246T
    bool

choice MCUX_HW_DEVICE_PART_MCXN246T
    prompt "Device MCXN246T Part"
    config MCUX_HW_DEVICE_PART_MCXN246TVAB
    bool "MCXN246TVAB"
    select MCUX_HW_DEVICE_ID_MCXN246T
endchoice

config MCUX_HW_DEVICE_ID
    string
    default "MCXN246T" if MCUX_HW_DEVICE_ID_MCXN246T

config MCUX_HW_DEVICE_PART
    string
    default "MCXN246TVAB" if MCUX_HW_DEVICE_PART_MCXN246TVAB

config MCUX_HW_IP_DriverType_FLEXIO_MCULCD
    bool
    default y
    depends on MCUX_HW_DEVICE_ID_MCXN246T

config MCUX_HW_IP_DriverType_SMARTCARD_EMVSIM
    bool
    default y
    depends on MCUX_HW_DEVICE_ID_MCXN246T

# ip information
config MCUX_HW_IP_DriverType_AHBSC
    bool
    default y
    depends on MCUX_HW_DEVICE_ID_MCXN246T

config MCUX_HW_IP_DriverType_CACHE64_CTRL
    bool
    default y
    depends on MCUX_HW_DEVICE_ID_MCXN246T

config MCUX_HW_IP_DriverType_CACHE64_POLSEL
    bool
    default y
    depends on MCUX_HW_DEVICE_ID_MCXN246T

config MCUX_HW_IP_DriverType_CDOG
    bool
    default y
    depends on MCUX_HW_DEVICE_ID_MCXN246T

config MCUX_HW_IP_DriverType_CRC
    bool
    default y
    depends on MCUX_HW_DEVICE_ID_MCXN246T

config MCUX_HW_IP_DriverType_CTIMER
    bool
    default y
    depends on MCUX_HW_DEVICE_ID_MCXN246T

config MCUX_HW_IP_DriverType_DBGMB
    bool
    default y
    depends on MCUX_HW_DEVICE_ID_MCXN246T

config MCUX_HW_IP_DriverType_DIGTMP
    bool
    default y
    depends on MCUX_HW_DEVICE_ID_MCXN246T

config MCUX_HW_IP_DriverType_EDMA3
    bool
    default y
    depends on MCUX_HW_DEVICE_ID_MCXN246T

config MCUX_HW_IP_DriverType_EIM
    bool
    default y
    depends on MCUX_HW_DEVICE_ID_MCXN246T

config MCUX_HW_IP_DriverType_EMVSIM
    bool
    default y
    depends on MCUX_HW_DEVICE_ID_MCXN246T

config MCUX_HW_IP_DriverType_ERM
    bool
    default y
    depends on MCUX_HW_DEVICE_ID_MCXN246T

config MCUX_HW_IP_DriverType_EVTG
    bool
    default y
    depends on MCUX_HW_DEVICE_ID_MCXN246T

config MCUX_HW_IP_DriverType_EWM
    bool
    default y
    depends on MCUX_HW_DEVICE_ID_MCXN246T

config MCUX_HW_IP_DriverType_FLEXCAN
    bool
    default y
    depends on MCUX_HW_DEVICE_ID_MCXN246T

config MCUX_HW_IP_DriverType_FLEXIO
    bool
    default y
    depends on MCUX_HW_DEVICE_ID_MCXN246T

config MCUX_HW_IP_DriverType_FLEXSPI
    bool
    default y
    depends on MCUX_HW_DEVICE_ID_MCXN246T

config MCUX_HW_IP_DriverType_FLEXSPI_IPED
    bool
    default y
    depends on MCUX_HW_DEVICE_ID_MCXN246T

config MCUX_HW_IP_DriverType_FMC
    bool
    default y
    depends on MCUX_HW_DEVICE_ID_MCXN246T

config MCUX_HW_IP_DriverType_FMU
    bool
    default y
    depends on MCUX_HW_DEVICE_ID_MCXN246T

config MCUX_HW_IP_DriverType_FREQME
    bool
    default y
    depends on MCUX_HW_DEVICE_ID_MCXN246T

config MCUX_HW_IP_DriverType_GDET
    bool
    default y
    depends on MCUX_HW_DEVICE_ID_MCXN246T

config MCUX_HW_IP_DriverType_GPIO
    bool
    default y
    depends on MCUX_HW_DEVICE_ID_MCXN246T

config MCUX_HW_IP_DriverType_HPDAC
    bool
    default y
    depends on MCUX_HW_DEVICE_ID_MCXN246T

config MCUX_HW_IP_DriverType_I3C
    bool
    default y
    depends on MCUX_HW_DEVICE_ID_MCXN246T

config MCUX_HW_IP_DriverType_INPUTMUX
    bool
    default y
    depends on MCUX_HW_DEVICE_ID_MCXN246T

config MCUX_HW_IP_DriverType_INTM
    bool
    default y
    depends on MCUX_HW_DEVICE_ID_MCXN246T

config MCUX_HW_IP_DriverType_IPCSS
    bool
    default y
    depends on MCUX_HW_DEVICE_ID_MCXN246T

config MCUX_HW_IP_DriverType_ITRC
    bool
    default y
    depends on MCUX_HW_DEVICE_ID_MCXN246T

config MCUX_HW_IP_DriverType_LPADC
    bool
    default y
    depends on MCUX_HW_DEVICE_ID_MCXN246T

config MCUX_HW_IP_DriverType_LPCMP
    bool
    default y
    depends on MCUX_HW_DEVICE_ID_MCXN246T

config MCUX_HW_IP_DriverType_LPDAC
    bool
    default y
    depends on MCUX_HW_DEVICE_ID_MCXN246T

config MCUX_HW_IP_DriverType_LPFLEXCOMM
    bool
    default y
    depends on MCUX_HW_DEVICE_ID_MCXN246T

config MCUX_HW_IP_DriverType_LPFLEXCOMM_LPI2C
    bool
    default y
    depends on MCUX_HW_DEVICE_ID_MCXN246T

config MCUX_HW_IP_DriverType_LPFLEXCOMM_LPSPI
    bool
    default y
    depends on MCUX_HW_DEVICE_ID_MCXN246T

config MCUX_HW_IP_DriverType_LPFLEXCOMM_LPUART
    bool
    default y
    depends on MCUX_HW_DEVICE_ID_MCXN246T

config MCUX_HW_IP_DriverType_LPTMR
    bool
    default y
    depends on MCUX_HW_DEVICE_ID_MCXN246T

config MCUX_HW_IP_DriverType_MCX_CMC
    bool
    default y
    depends on MCUX_HW_DEVICE_ID_MCXN246T

config MCUX_HW_IP_DriverType_MCX_ENET
    bool
    default y
    depends on MCUX_HW_DEVICE_ID_MCXN246T

config MCUX_HW_IP_DriverType_MCX_SPC
    bool
    default y
    depends on MCUX_HW_DEVICE_ID_MCXN246T

config MCUX_HW_IP_DriverType_MCX_VBAT
    bool
    default y
    depends on MCUX_HW_DEVICE_ID_MCXN246T

config MCUX_HW_IP_DriverType_MRT
    bool
    default y
    depends on MCUX_HW_DEVICE_ID_MCXN246T

config MCUX_HW_IP_DriverType_NPX
    bool
    default y
    depends on MCUX_HW_DEVICE_ID_MCXN246T

config MCUX_HW_IP_DriverType_OPAMP
    bool
    default y
    depends on MCUX_HW_DEVICE_ID_MCXN246T

config MCUX_HW_IP_DriverType_OSTIMER
    bool
    default y
    depends on MCUX_HW_DEVICE_ID_MCXN246T

config MCUX_HW_IP_DriverType_OTPC
    bool
    default y
    depends on MCUX_HW_DEVICE_ID_MCXN246T

config MCUX_HW_IP_DriverType_PINT
    bool
    default y
    depends on MCUX_HW_DEVICE_ID_MCXN246T

config MCUX_HW_IP_DriverType_PKC
    bool
    default y
    depends on MCUX_HW_DEVICE_ID_MCXN246T

config MCUX_HW_IP_DriverType_PLU
    bool
    default y
    depends on MCUX_HW_DEVICE_ID_MCXN246T

config MCUX_HW_IP_DriverType_PORT
    bool
    default y
    depends on MCUX_HW_DEVICE_ID_MCXN246T

config MCUX_HW_IP_DriverType_PUFCTRL
    bool
    default y
    depends on MCUX_HW_DEVICE_ID_MCXN246T

config MCUX_HW_IP_DriverType_PUFV3
    bool
    default y
    depends on MCUX_HW_DEVICE_ID_MCXN246T

config MCUX_HW_IP_DriverType_PWM
    bool
    default y
    depends on MCUX_HW_DEVICE_ID_MCXN246T

config MCUX_HW_IP_DriverType_QDC
    bool
    default y
    depends on MCUX_HW_DEVICE_ID_MCXN246T

config MCUX_HW_IP_DriverType_RTC_V2
    bool
    default y
    depends on MCUX_HW_DEVICE_ID_MCXN246T

config MCUX_HW_IP_DriverType_SCG
    bool
    default y
    depends on MCUX_HW_DEVICE_ID_MCXN246T

config MCUX_HW_IP_DriverType_SCTIMER
    bool
    default y
    depends on MCUX_HW_DEVICE_ID_MCXN246T

config MCUX_HW_IP_DriverType_SINC
    bool
    default y
    depends on MCUX_HW_DEVICE_ID_MCXN246T

config MCUX_HW_IP_DriverType_SMARTDMA
    bool
    default y
    depends on MCUX_HW_DEVICE_ID_MCXN246T

config MCUX_HW_IP_DriverType_SMARTDMA_MCXN
    bool
    default y
    depends on MCUX_HW_DEVICE_ID_MCXN246T

config MCUX_HW_IP_DriverType_SWD
    bool
    default y
    depends on MCUX_HW_DEVICE_ID_MCXN246T

config MCUX_HW_IP_DriverType_SYSCON_LPCAC
    bool
    default y
    depends on MCUX_HW_DEVICE_ID_MCXN246T

config MCUX_HW_IP_DriverType_SYSPM
    bool
    default y
    depends on MCUX_HW_DEVICE_ID_MCXN246T

config MCUX_HW_IP_DriverType_TRDC_1
    bool
    default y
    depends on MCUX_HW_DEVICE_ID_MCXN246T

config MCUX_HW_IP_DriverType_USBHSDCD
    bool
    default y
    depends on MCUX_HW_DEVICE_ID_MCXN246T

config MCUX_HW_IP_DriverType_USBNC
    bool
    default y
    depends on MCUX_HW_DEVICE_ID_MCXN246T

config MCUX_HW_IP_DriverType_USB_HOST_DEVICE_EHCI
    bool
    default y
    depends on MCUX_HW_DEVICE_ID_MCXN246T

config MCUX_HW_IP_DriverType_USB_HOST_DEVICE_KHCI
    bool
    default y
    depends on MCUX_HW_DEVICE_ID_MCXN246T

config MCUX_HW_IP_DriverType_USB_HSDCD
    bool
    default y
    depends on MCUX_HW_DEVICE_ID_MCXN246T

config MCUX_HW_IP_DriverType_USB_PHY
    bool
    default y
    depends on MCUX_HW_DEVICE_ID_MCXN246T

config MCUX_HW_IP_DriverType_UTICK
    bool
    default y
    depends on MCUX_HW_DEVICE_ID_MCXN246T

config MCUX_HW_IP_DriverType_VREF_1
    bool
    default y
    depends on MCUX_HW_DEVICE_ID_MCXN246T

config MCUX_HW_IP_DriverType_WUU
    bool
    default y
    depends on MCUX_HW_DEVICE_ID_MCXN246T

config MCUX_HW_IP_DriverType_WWDT
    bool
    default y
    depends on MCUX_HW_DEVICE_ID_MCXN246T
```
